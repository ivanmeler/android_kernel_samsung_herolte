/*
 * SAMSUNG EXYNOS8890 SoC device tree source
 *
 * Copyright (c) 2015 Samsung Electronics Co., Ltd.
 *		http://www.samsung.com
 *
 * SAMSUNG EXYNOS8890 SoC device nodes are listed in this file.
 * EXYNOS8890 based board files can include this file and provide
 * values for board specfic bindings.
 *
 * This program is free software; you can redistribute it and/or modify
 * it under the terms of the GNU General Public License version 2 as
 * published by the Free Software Foundation.
 */

/ {
	BUSMON@0 {
		compatible = "samsung,exynos-busmonitor";
	};
};
