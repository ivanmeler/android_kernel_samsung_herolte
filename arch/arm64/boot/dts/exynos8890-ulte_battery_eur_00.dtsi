/*
 * SAMSUNG UNIVERSAL5433 board device tree source
 *
 * Copyright (c) 2013 Samsung Electronics Co., Ltd.
 *		http://www.samsung.com
 *
 * This program is free software; you can redistribute it and/or modify
 * it under the terms of the GNU General Public License version 2 as
 * published by the Free Software Foundation.
*/
#include "exynos8890-ulte_battery.dtsi"
/ {
	battery {
		battery,fast_charging_current = <1800 450 450 1800 800 1200 1000 460 1200 450 1800 1800 1800 1600 1800 450 450 400 700 1300 300 1000 1500 450 1800 1800 1000 1800 80 1800 1000 1400 450 1000 1800 1800 1800 1800>;
	};
};
