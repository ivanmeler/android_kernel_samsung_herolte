/*
 * SAMSUNG UNIVERSAL7420 board device tree source
 *
 * Copyright (c) 2014 Samsung Electronics Co., Ltd.
 *		http://www.samsung.com
 *
 * This program is free software; you can redistribute it and/or modify
 * it under the terms of the GNU General Public License version 2 as
 * published by the Free Software Foundation.
*/

/ {
	haptic {
		status = "okay";
		haptic,model = <1>;
		haptic,max_timeout = <10000>;
		haptic,duty = <32850>;
		haptic,period = <37820>;
		haptic,reg2 = <0x82>;
		haptic,pwm_id = <1>;
		haptic,regulator_name = "VDD_MOT_3.3V";
	};
};
