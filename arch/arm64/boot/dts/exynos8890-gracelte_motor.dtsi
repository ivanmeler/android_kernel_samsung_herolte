/*
 * SAMSUNG UNIVERSAL7420 board device tree source
 *
 * Copyright (c) 2014 Samsung Electronics Co., Ltd.
 *		http://www.samsung.com
 *
 * This program is free software; you can redistribute it and/or modify
 * it under the terms of the GNU General Public License version 2 as
 * published by the Free Software Foundation.
*/

/ {
	haptic {
		status = "okay";
		haptic,model = <1>;
		haptic,max_timeout = <10000>;
		/* for multi-frequency */
		haptic,multi_frequency = <5>;
		haptic,multi_frequency_divider = <78125000>; /* 1s/128(pdiv)=7812500 */
		/* frequency     alert low   mid   high  0 */
		haptic,duty   = <46386 61848 49478 37108 41231>;
		haptic,period = <48828 65104 52083 39062 43402>;
		haptic,reg2 = <0x82>;
		haptic,pwm_id = <1>;
		haptic,regulator_name = "VDD_MOT_3.3V";
	};
};
