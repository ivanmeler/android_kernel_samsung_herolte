/*
 * SAMSUNG UNIVERSAL8890 board device tree source
 *
 * Copyright (c) 2015 Samsung Electronics Co., Ltd.
 *		http://www.samsung.com
 *
 * This program is free software; you can redistribute it and/or modify
 * it under the terms of the GNU General Public License version 2 as
 * published by the Free Software Foundation.
*/

/ {
	rgb {
		led_device_type = <3>;
		rgb-name = "led_w", "led_r", "led_g", "led_b";

		normal_powermode_current = <10>;
		low_powermode_current = <10>;
		br_ratio_r = <970>;
		br_ratio_g = <200>;
		br_ratio_b = <1250>;
		br_ratio_r_low = <100>;
		br_ratio_g_low = <30>;
		br_ratio_b_low = <130>;
	};
};
