/*
 * SAMSUNG UNIVERSAL8890 board device tree source
 *
 * Copyright (c) 2015 Samsung Electronics Co., Ltd.
 *		http://www.samsung.com
 *
 * This program is free software; you can redistribute it and/or modify
 * it under the terms of the GNU General Public License version 2 as
 * published by the Free Software Foundation.
*/

/ {
	rgb {
		led_device_type = <2>;
		rgb-name = "led_w", "led_r", "led_g", "led_b";

		normal_powermode_current = <10>;
		low_powermode_current = <10>;
		br_ratio_r = <100>;
		br_ratio_g = <40>;
		br_ratio_b = <210>;
		br_ratio_r_low = <20>;
		br_ratio_g_low = <10>;
		br_ratio_b_low = <40>;

		normal_powermode_current_u = <10>;
		low_powermode_current_u = <10>;
		br_ratio_r_u = <520>;
		br_ratio_g_u = <410>;
		br_ratio_b_u = <360>;
		br_ratio_r_low_u = <50>;
		br_ratio_g_low_u = <30>;
		br_ratio_b_low_u = <30>;

		normal_powermode_current_bk = <10>;
		low_powermode_current_bk = <10>;
		br_ratio_r_bk = <520>;
		br_ratio_g_bk = <60>;
		br_ratio_b_bk = <200>;
		br_ratio_r_low_bk = <50>;
		br_ratio_g_low_bk = <10>;
		br_ratio_b_low_bk = <20>;

		normal_powermode_current_gd = <10>;
		low_powermode_current_gd = <10>;
		br_ratio_r_gd = <370>;
		br_ratio_g_gd = <130>;
		br_ratio_b_gd = <1400>;
		br_ratio_r_low_gd = <30>;
		br_ratio_g_low_gd = <10>;
		br_ratio_b_low_gd = <70>;

		normal_powermode_current_sv = <10>;
		low_powermode_current_sv = <10>;
		br_ratio_r_sv = <260>;
		br_ratio_g_sv = <90>;
		br_ratio_b_sv = <730>;
		br_ratio_r_low_sv = <20>;
		br_ratio_g_low_sv = <10>;
		br_ratio_b_low_sv = <50>;

		normal_powermode_current_bl = <10>;
		low_powermode_current_bl = <10>;
		br_ratio_r_bl = <280>;
		br_ratio_g_bl = <110>;
		br_ratio_b_bl = <1100>;
		br_ratio_r_low_bl = <20>;
		br_ratio_g_low_bl = <10>;
		br_ratio_b_low_bl = <80>;

		normal_powermode_current_pg = <10>;
		low_powermode_current_pg = <10>;
		br_ratio_r_pg = <290>;
		br_ratio_g_pg = <110>;
		br_ratio_b_pg = <600>;
		br_ratio_r_low_pg = <30>;
		br_ratio_g_low_pg = <10>;
		br_ratio_b_low_pg = <40>;
	};
};
