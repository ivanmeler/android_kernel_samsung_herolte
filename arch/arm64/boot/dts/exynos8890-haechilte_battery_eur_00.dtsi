/*
 * SAMSUNG UNIVERSAL5433 board device tree source
 *
 * Copyright (c) 2013 Samsung Electronics Co., Ltd.
 *		http://www.samsung.com
 *
 * This program is free software; you can redistribute it and/or modify
 * it under the terms of the GNU General Public License version 2 as
 * published by the Free Software Foundation.
*/

#include "exynos8890-haechilte_battery.dtsi"
/ {
	battery {
		battery,chg_high_temp = <470>;
		battery,chg_high_temp_recovery = <420>;
	};
};