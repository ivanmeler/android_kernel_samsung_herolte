/*
 * SAMSUNG UNIVERSAL5433 board device tree source
 *
 * Copyright (c) 2013 Samsung Electronics Co., Ltd.
 *		http://www.samsung.com
 *
 * This program is free software; you can redistribute it and/or modify
 * it under the terms of the GNU General Public License version 2 as
 * published by the Free Software Foundation.
*/

#include "exynos8890-herolte_battery.dtsi"
/ {
	pinctrl@10580000 {
		/delete-node/ wpc_int;
		/delete-node/ wcin_ok;
		/delete-node/ wpc_det;
	};

	hsi2c@14E30000 {
		status = "disabled";
		/delete-node/ p9220-charger@61;
	};

	battery {
		/delete-property/ pinctrl-names;
		/delete-property/ pinctrl-0;
		/delete-property/ battery,wpc_int;
		/delete-property/ battery,wpc_det;
		/delete-property/ battery,wireless_charger_name;
	};
};