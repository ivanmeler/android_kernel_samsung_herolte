/*
 * SAMSUNG UNIVERSAL5433 board device tree source
 *
 * Copyright (c) 2013 Samsung Electronics Co., Ltd.
 *		http://www.samsung.com
 *
 * This program is free software; you can redistribute it and/or modify
 * it under the terms of the GNU General Public License version 2 as
 * published by the Free Software Foundation.
*/

#include "exynos8890-gracelte_common_battery.dtsi"
/ {
	battery {
		battery,input_current_limit = <1700 450 450 1700 500 900 1500 460 1000 450 900 900 900 1900 2000 450 450 400 700 1300 300 1000 1500 450 1675 2100 1000 1675 80 1800 1675 1400 1000 1000 700 900 900 900 500 2000>;

		battery,wpc_high_temp = <430 465>;
		battery,wpc_high_temp_recovery = <429 370>;
		battery,wpc_lcd_on_high_temp = <400>;
	};

	max77854-fuelgauge {
		fuelgauge,fg_resistor = <2>;
	};
};