## drivers/trace/Kconfig
```kconfig
#
# Trace(debugging) driver configuration
#

menuconfig TRACE
	bool "TRACE driver support"
	default y
	help
	  The "TRACE driver" is a kind of driver for debugging

if TRACE

config EXYNOS_DRAMTEST
	bool "Exynos DRAMTEST driver"
	help
	  This driver is to test DRAM. It write all 2MB with data 1.

config EXYNOS_BUSMONITOR
	bool "Exynos BUS Monitor support(logging / timeout)"
	default y
	depends on ARCH_EXYNOS

menuconfig EXYNOS_SNAPSHOT
	bool "Exynos SnapShot(ESS) support for debugging"
	default y
	depends on ARCH_EXYNOS

config EXYNOS_SNAPSHOT_CALLSTACK
	int "shown callstack level"
	depends on EXYNOS_SNAPSHOT
	range 1 4
	default 4

config EXYNOS_SNAPSHOT_IRQ_EXIT
	bool "Enable debugging of interrupt exit event by kevent"
	depends on EXYNOS_SNAPSHOT && !EXYNOS_SNAPSHOT_MINIMIZED_MODE
	default y

config EXYNOS_SNAPSHOT_IRQ_EXIT_THRESHOLD
	int "threshold of detection(microsecond)"
	depends on EXYNOS_SNAPSHOT_IRQ_EXIT && !EXYNOS_SNAPSHOT_MINIMIZED_MODE
	range 0 1000000
	default 0

config EXYNOS_SNAPSHOT_IRQ_DISABLED
	bool "Enable debugging of interrupt disable event by kevent(EXPERIMENTAL)"
	depends on EXYNOS_SNAPSHOT && !EXYNOS_SNAPSHOT_MINIMIZED_MODE
	default n

config EXYNOS_SNAPSHOT_SPINLOCK
	bool "Enable debugging of spinlock event by kevent(EXPERIMENTAL)"
	depends on EXYNOS_SNAPSHOT && DEBUG_SPINLOCK && !EXYNOS_SNAPSHOT_MINIMIZED_MODE
	default y

config EXYNOS_SNAPSHOT_CLK
	bool "Enable debugging of clock event by kevent(EXPERIMENTAL)"
	depends on EXYNOS_SNAPSHOT && !EXYNOS_SNAPSHOT_MINIMIZED_MODE
	default y

config EXYNOS_SNAPSHOT_FREQ
	bool "Enable debugging of frequence event by kevent(EXPERIMENTAL)"
	depends on EXYNOS_SNAPSHOT && PM_DEVFREQ && !EXYNOS_SNAPSHOT_MINIMIZED_MODE
	default y

config EXYNOS_SNAPSHOT_HRTIMER
	bool "Enable debugging of hrtimer by kevent"
	depends on EXYNOS_SNAPSHOT && !EXYNOS_SNAPSHOT_MINIMIZED_MODE
	default n

config EXYNOS_SNAPSHOT_REG
	bool "Enable debugging of accessing register by kevent"
	depends on EXYNOS_SNAPSHOT && !EXYNOS_SNAPSHOT_MINIMIZED_MODE
	default n

config EXYNOS_SNAPSHOT_REGULATOR
	bool "Enable debugging of regulator and pmic driver"
	depends on EXYNOS_SNAPSHOT && !EXYNOS_SNAPSHOT_MINIMIZED_MODE
	default y

config EXYNOS_SNAPSHOT_THERMAL
	bool "Enable debugging of thermal driver"
	depends on EXYNOS_SNAPSHOT && !EXYNOS_SNAPSHOT_MINIMIZED_MODE && EXYNOS_THERMAL
	default y

config EXYNOS_SNAPSHOT_MBOX
	bool "Enable debugging of mailbox for transferring with APM"
	depends on EXYNOS_SNAPSHOT && EXYNOS_MBOX && !EXYNOS_SNAPSHOT_MINIMIZED_MODE
	default y

config EXYNOS_SNAPSHOT_HOOK_LOGGER
	bool "Enable hooking android platform log for ramdump"
	depends on EXYNOS_SNAPSHOT
	default y

config EXYNOS_SNAPSHOT_PSTORE
	bool "Enable supporting ramoops driver for pstore filesystem"
	depends on EXYNOS_SNAPSHOT
	depends on ANDROID_MAJOR_VERSION != "m"
	depends on ANDROID_MAJOR_VERSION != "l"
	depends on ANDROID_MAJOR_VERSION != "k"
	select PSTORE
	select PSTORE_RAM
	select PSTORE_PMSG
	default n

config EXYNOS_SNAPSHOT_PANIC_REBOOT
	bool "Enable forced reboot after panic for ramdump"
	depends on EXYNOS_SNAPSHOT
	default y

config EXYNOS_SNAPSHOT_WATCHDOG_RESET
	bool "Support watchdog reset when hardlockup detect"
	depends on EXYNOS_SNAPSHOT && EXYNOS_SNAPSHOT_PANIC_REBOOT
	default y

config EXYNOS_SNAPSHOT_CRASH_KEY
	bool "Support Crash Key to artificial panic for debugging"
	depends on EXYNOS_SNAPSHOT && KEYBOARD_GPIO
	default n

config EXYNOS_SNAPSHOT_SFRDUMP
	bool "Support dump of sfr region for debugging"
	depends on EXYNOS_SNAPSHOT && !EXYNOS_SNAPSHOT_MINIMIZED_MODE
	default n

config EXYNOS_SNAPSHOT_SFRDUMP_ADV
	bool "SFRDUMP with checking power of IP"
	depends on EXYNOS_SNAPSHOT_SFRDUMP
	default y

config EXYNOS_SNAPSHOT_MINIMIZED_MODE
	bool "Support minimized feature configuration"
	depends on EXYNOS_SNAPSHOT
	default n

config EXYNOS_SNAPSHOT_LOGGING_SMC_CALL
	bool "Support logging SMC call"
	depends on EXYNOS_SNAPSHOT
	default n

menuconfig EXYNOS_CORESIGHT
	bool "Enable Coresight of exynos"
	depends on ARCH_EXYNOS
	default n

config EXYNOS_CORESIGHT_PC_INFO
	bool "Show Porgram Counter information"
	depends on EXYNOS_CORESIGHT
	default y
	help
	  Show Program Counter information When kernel panic.

config PC_ITERATION
	int "Number of Program Coutner information"
	depends on EXYNOS_CORESIGHT_PC_INFO
	range 1 10
	default 10
	help
	  Print out Program Counter as iteration value.

config EXYNOS_CORESIGHT_MAINTAIN_DBG_REG
	bool "Save/Restore Debug Registers"
	depends on EXYNOS_CORESIGHT
	default n
	help
	  When core power is down, debug registers are not mainained data
	  and OS-lock is set. To maintain data, debug registers's data must
	  save in /restore from memory. If OS-lock is set, debugging to use
	  trace32 is impossible. So OS-lock must clear when core power is up.
	  This config must enable only using iTSP program.

menuconfig EXYNOS_CORESIGHT_ETM
	bool "Enable ETM driver of exynos"
	depends on ARCH_EXYNOS
	default n
	help
	  ETM driver is a driver for debugging. Also this driver enable ETR of
	  coresight feature.

config EXYNOS_CORESIGHT_ETB
	bool "This system has ETB feature"
	depends on EXYNOS_CORESIGHT_ETM && SOC_EXYNOS7580
	default n
	help
	  ETB driver is the sink part of coresight components. Some coresights has
	  ETR.

config EXYNOS_CORESIGHT_ETF
	bool "This system has ETF feature"
	depends on EXYNOS_CORESIGHT_ETM
	default n
	help
	  ETF driver is the sink part of coresight components. Some coresights has
	  ETR.

config EXYNOS_CORESIGHT_ETR
	bool "This system has ETR feature"
	depends on EXYNOS_CORESIGHT_ETF && EXYNOS_SNAPSHOT
	default n
	help
	  ETR driver is a driver for debugging. Also this driver is thr sink part of
	  coresight feature. Coresight consists of source, link, sink part.
	  This routes to DRAM or USB.


config EXYNOS_CORESIGHT_ETM_SYSFS
	bool "This system has ETM Sysfs feature"
	depends on EXYNOS_CORESIGHT_ETM
	default n
	help
	  Show ETM, FUNNEL, ETB, ETF and ETR status through sysfs.

config EXYNOS_CORESIGHT_STM
	bool "Enable STM driver of exynos"
	depends on ARCH_EXYNOS
	default n
	help
	  STM driver is a driver for H/W event and S/W event debugging.

endif
#
```

## drivers/video/fbdev/exynos/decon_8890/Kconfig
```kconfig
config EXYNOS_DECON_8890
	bool "Samsung Exynos8890 Display system (VPP, DECON, MIPI, HDMI)"
	depends on FB

if EXYNOS_DECON_8890
config USE_VSYNC_SKIP
	bool "Vsync Skip Enable"
	depends on EXYNOS_DECON_8890
	default n
	help
	  Say Y here if you want to enable vsync skip feature for DFS solution.

config EXYNOS_DECON_FB
	bool "Samsung DECON Framebuffer driver"
	depends on EXYNOS_DECON_8890
	select MEDIA_EXYNOS
	default y
	help
	  Say Y here if you want support for the DECON in Samsung S5P SoCs.
	  This device produce image data to one of output interfaces.

config EXYNOS_MIPI_DSI
	bool "Samsung Exynos MIPI-DSI driver"
	depends on EXYNOS_DECON_8890
	default y
	help
	  Enable MIPI-DSI driver.

config DECON_MIPI_DSI_PKTGO
	bool "Samsung Exynos MIPI-DSI Packet Go"
	depends on EXYNOS_MIPI_DSI
	default n
	help
	  Enable/disable MIPI-DSI Packet Go function

config DECON_LPD_DISPLAY
        bool "Decon Low Power Display MODE"
        depends on EXYNOS_DECON_8890
        default n

config FB_WINDOW_UPDATE
        bool "DECON window update mode"
        depends on EXYNOS_DECON_8890
        default n

config DECON_BLOCKING_MODE
	bool "DECON blocking mode"
        depends on EXYNOS_DECON_8890
        default n

config FB_DSU
	bool "DECON DSU mode"
	depends on EXYNOS_DECON_8890 && FB_WINDOW_UPDATE
	default n

config FB_DSU_NOT_SEAMLESS
	bool "LCD cannot sealmess while multi-resolution"
	depends on FB_DSU
	default n

config FB_DSU_REG_LOCK
	bool "Lock register while multi-resolution (only HF4)"
	depends on FB_DSU
	default n

config DECON_EVENT_LOG
	bool "Display sub-system event logger (DECON/DSIM/VPP)"
        depends on DEBUG_INFO && EXYNOS_DECON_8890
        default y

config DSIM_ESD_RECOVERY_NOPOWER
	bool "Not control power/reset in esd recovery"
        default n

config DSIM_ESD_REMOVE_DISP_DET
        bool "To Remove DISP_DET gpio irq for ESD"
        default n

config ALWAYS_RELOAD_MTP_FACTORY_BUILD
	bool "reaload MTP/MDNIE every LCD-on times"
	depends on SEC_FACTORY
	default n

config CHECK_OCTA_CHIP_ID
	bool "support to check octa chip id"
	default n

config LCD_RES
	bool "change LCD-resolution by BOOT_PARAM"
	default n

config DECON_SELF_REFRESH
	bool "DECON self refresh"
	depends on EXYNOS_DECON_8890
	default n

config LOGGING_BIGDATA_BUG
	bool "Logging extra information when decon bug"
	depends on EXYNOS_DECON_8890
	default n

config DUMPSTATE_LOGGING
	bool "Support DumpState Logging"
	depends on EXYNOS_DECON_8890
	default n

config CHECK_DECON_TIME
	bool "Check Decon thread time"
	depends on EXYNOS_DECON_8890 && DUMPSTATE_LOGGING
	default n

source "drivers/video/fbdev/exynos/decon_8890/vpp/Kconfig"

endif

source "drivers/video/fbdev/exynos/decon_8890/panels/Kconfig"
```

## drivers/video/fbdev/exynos/decon_8890/panels/Kconfig
```kconfig
config EXYNOS_DECON_LCD
	depends on EXYNOS_DECON_8890
	bool "Select LCD panel driver"

config EXYNOS_DECON_MDNIE_LITE
	depends on EXYNOS_DECON_LCD
	tristate "Support MDNIE LITE"
	default n

config EXYNOS_DECON_LCD_SYSFS
	depends on EXYNOS_DECON_LCD
	tristate "Support LCD SYSFS"
	default y

config PANEL_AID_DIMMING
	depends on EXYNOS_DECON_LCD
	tristate "Support AID Dimming"
	default n

config PANEL_SMART_DIMMING
	depends on PANEL_AID_DIMMING
	tristate "Support SMART Dimming"
	default n

config EXYNOS_DECON_LCD_MCD
	depends on EXYNOS_DECON_LCD_SYSFS
	tristate "Support MCD"
	default n

config LCD_HMT
	depends on EXYNOS_DECON_LCD
	tristate "Support HMT display"
	default n

config LCD_ALPM
	depends on EXYNOS_DECON_LCD
	tristate "Support ALPM display"
	default n

config LCD_DOZE_MODE
	depends on EXYNOS_DECON_LCD
	tristate "Support DOZE MODE"
	default n

config LCD_ESD_IDLE_MODE
	depends on EXYNOS_DECON_LCD
	tristate "Support HA3 PANEL FOR ESD"
	default n

config PANEL_S6E3HF4_WQHD
	depends on EXYNOS_DECON_LCD && EXYNOS_MIPI_DSI
	tristate "S6E3HF4 AMOLED SUPPORT WQHD RESOLUTION"

config PANEL_S6E3HF4_WQHD_HAECHI
	depends on EXYNOS_DECON_LCD && EXYNOS_MIPI_DSI
	tristate "S6E3HF4 AMOLED SUPPORT WQHD RESOLUTION FOR HAECHI"

config PANEL_S6E3HA5_WQHD
	depends on EXYNOS_DECON_LCD && EXYNOS_MIPI_DSI
	tristate "S6E3HA5 AMOLED SUPPORT WQHD RESOLUTION"

config PANEL_S6E3FA2_FHD
	depends on EXYNOS_DECON_LCD && EXYNOS_MIPI_DSI
	tristate "S6E3FA2 AMOLED SUPPORT FHD RESULOTION"

config PANEL_S6E3HF2_WQXGA
	depends on EXYNOS_DECON_LCD && EXYNOS_MIPI_DSI
	tristate "S6E3HF2 AMOLED SUPPORT WQXGA RESOLUTION"

config PANEL_S6E3HF4_WQXGA
	depends on EXYNOS_DECON_LCD && EXYNOS_MIPI_DSI
	tristate "S6E3HF4 AMOLED SUPPORT WQXGA RESOLUTION"

config PANEL_S6E3HA3_DYNAMIC
	depends on EXYNOS_DECON_LCD && EXYNOS_MIPI_DSI
	tristate "S6E3HA3 AMOLED SUPPORT BOTH S6E3HA2/S6E3HA3/S6E3HF4 (1440 x 2560)"

config SUPPORT_CROSS_DOWNLOAD
	depends on EXYNOS_DECON_LCD && EXYNOS_MIPI_DSI
	tristate "PANEL SUPPORT CROSS DOWNLOAD"

config LCD_WEAKNESS_CCB
	depends on EXYNOS_DECON_LCD && EXYNOS_MIPI_DSI
	tristate "PANEL SUPPORT CCB"

config PANEL_DDI_SPI
	depends on EXYNOS_DECON_LCD && EXYNOS_MIPI_DSI
	tristate "DDI SPI"

config PANEL_DUALIZATION
	depends on PANEL_S6E3HF4_WQHD
	tristate "S6E3HF4 A2 PANEL DUALIZATION"

config LCD_BURNIN_CORRECTION
	depends on EXYNOS_DECON_LCD
	tristate "Support Burnin correction"
	default n

config VDDR_1p5V_ALPM
	tristate "Grace : VDDR 1.5V in AOD mode"
	default n

config DISPLAY_USE_INFO
	depends on EXYNOS_DECON_LCD
	tristate "Support display use info logging"
	default n

config PANEL_CALL_MDNIE
	depends on EXYNOS_DECON_LCD && EXYNOS_MIPI_DSI
	tristate "Support panel call mdnie update"
	default n

config SUPPORT_POC_FLASH
	depends on EXYNOS_DECON_LCD && PANEL_S6E3HA5_WQHD
	tristate "Support display poc flash"
	default n

config POC_GRACE
	depends on EXYNOS_DECON_LCD && PANEL_S6E3HA5_WQHD && SUPPORT_POC_FLASH
	tristate "Support poc for grace"
	default n

config PANEL_GRAY_SPOT
	depends on EXYNOS_DECON_LCD
	tristate "Support gray spot test"
	default n
```

## drivers/video/fbdev/exynos/decon_8890/vpp/Kconfig
```kconfig
config EXYNOS_VPP
	bool "Samsung Exynos Video Post Processor driver"
	depends on EXYNOS_DECON_8890
	default y
	help
	  Enable VPP driver.
```

## drivers/video/fbdev/exynos/decon_8890_dual_display/Kconfig
```kconfig
config EXYNOS_DECON_8890_DUAL_DISPLAY
	bool "Samsung Exynos8890 Display system (VPP, DECON, MIPI, HDMI)"
	depends on FB

if EXYNOS_DECON_8890_DUAL_DISPLAY
config USE_VSYNC_SKIP
	bool "Vsync Skip Enable"
	depends on EXYNOS_DECON_8890_DUAL_DISPLAY
	default n
	help
	  Say Y here if you want to enable vsync skip feature for DFS solution.

config EXYNOS_DECON_FB
	bool "Samsung DECON Framebuffer driver"
	depends on EXYNOS_DECON_8890_DUAL_DISPLAY
	select MEDIA_EXYNOS
	default y
	help
	  Say Y here if you want support for the DECON in Samsung S5P SoCs.
	  This device produce image data to one of output interfaces.

config EXYNOS_MIPI_DSI
	bool "Samsung Exynos MIPI-DSI driver"
	depends on EXYNOS_DECON_8890_DUAL_DISPLAY
	default y
	help
	  Enable MIPI-DSI driver.

config DECON_MIPI_DSI_PKTGO
	bool "Samsung Exynos MIPI-DSI Packet Go"
	depends on EXYNOS_MIPI_DSI
	default n
	help
	  Enable/disable MIPI-DSI Packet Go function

config DECON_LPD_DISPLAY
        bool "Decon Low Power Display MODE"
        depends on EXYNOS_DECON_8890_DUAL_DISPLAY
        default n

config FB_WINDOW_UPDATE
        bool "DECON window update mode"
        depends on EXYNOS_DECON_8890_DUAL_DISPLAY
        default n

config DECON_BLOCKING_MODE
	bool "DECON blocking mode"
        depends on EXYNOS_DECON_8890_DUAL_DISPLAY
        default n

config DECON_EVENT_LOG
	bool "Display sub-system event logger (DECON/DSIM/VPP)"
        depends on DEBUG_INFO && EXYNOS_DECON_8890_DUAL_DISPLAY
        default y

source "drivers/video/fbdev/exynos/decon_8890_dual_display/vpp/Kconfig"

endif

source "drivers/video/fbdev/exynos/decon_8890_dual_display/panels/Kconfig"
```

## drivers/video/fbdev/exynos/decon_8890_dual_display/panels/Kconfig
```kconfig
config EXYNOS_DECON_LCD
	depends on EXYNOS_DECON_8890_DUAL_DISPLAY
	bool "Select LCD panel driver"

config EXYNOS_DECON_MDNIE_LITE
	depends on EXYNOS_DECON_LCD
	tristate "Support MDNIE LITE"
	default n

config EXYNOS_DECON_LCD_SYSFS
	depends on EXYNOS_DECON_LCD
	tristate "Support LCD SYSFS"
	default y

config PANEL_AID_DIMMING
	depends on EXYNOS_DECON_LCD
	tristate "Support AID Dimming"
	default n

config PANEL_S6E3HF2_WQXGA
	depends on EXYNOS_DECON_LCD && EXYNOS_MIPI_DSI
	tristate "S6E3HF2 AMOLED SUPPORT WQXGA RESOLUTION"

config PANEL_S6E36W0X10
	depends on EXYNOS_DECON_LCD && EXYNOS_MIPI_DSI
	tristate "S6E36W0X10 ALOMED SUPPORT 128 * 432 RESOLUTION"
```

## drivers/video/fbdev/exynos/decon_8890_dual_display/vpp/Kconfig
```kconfig
config EXYNOS_VPP
	bool "Samsung Exynos Video Post Processor driver"
	depends on EXYNOS_DECON_8890_DUAL_DISPLAY
	default y
	help
	  Enable VPP driver.
```
