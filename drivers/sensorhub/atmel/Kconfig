## drivers/sensorhub/stm/Kconfig
```kconfig
#
# sensor drivers configuration
#

config SENSORS_SSP
	tristate "Sensors ssp"
	default n
	depends on SPI
	help
	  ssp driver for sensor hub.
          If you say yes here you get ssp support for
	  sensor hub.
	  To compile this driver as a module, choose M here: the
	  module will be called ssp.

config SENSORS_SSP_STM
	tristate "Sensors ssp stm"
	default n
	depends on SPI
	help
	  ssp driver for sensor hub.
          If you say yes here you get ssp support for
	  sensor hub.
	  To compile this driver as a module, choose M here: the
	  module will be called ssp.

config SENSORS_MAX86900
	tristate "MAXIM MAX86900 HRM Sensor"
	default n
	depends on I2C && SYSFS
	help
	  If you say yes here you get support for the MAX86900
	  HRM sensor.
	  This driver can also be built as a module.  If so, the module
	  will be called max86900.

config SENSORS_MAX86902
	tristate "MAXIM MAX86902 UV HRM Sensor"
	default n
	depends on I2C
	help
	  If you say yes here you get support for the MAX86902
	  HRM sensor & uv sensor.
	  This driver can also be built as a module.  If so, the module
	  will be called MAX86902.

config SENSORS_MULTIPLE_GLASS_TYPE
	tristate "Sensors ssp multiple glass type"
	default n
	depends on SPI
	help
	  If you want to use multiple glass type, it should be set.

config SENSORS_SSP_IRDATA_FOR_CAMERA
	tristate "Sensors ssp irdata for camera"
	default n
	depends on SPI
	help
	  If you want to use irdata, it should be set.

config SENSORS_SX9310
	depends on I2C
	tristate "SX9310 driver"
	default n
	help
	  Say Y here if you use sx9310.
	  This option enables grip sensors using
	  SemTech sx9310 device driver.
	  Say N here if you do not use sx9310.

config SENSORS_SX9310_INIT_TOUCH_THRESHOLD
	int "SX9310 Grip sensor threshold for init touch"
	depends on SENSORS_SX9310
	default "3000"
	help
	  This value is the standard of init touch using
	  SemTech sx9310 device driver.

config SENSORS_SX9310_NORMAL_TOUCH_THRESHOLD
	int "SX9310 Grip sensor threshold for normal touch"
	depends on SENSORS_SX9310
	default "17"
	help
	  This value is the standard of normal touch using
	  SemTech sx9310 device driver.

config SENSORS_SX9310_CP_LDO_CONTROL
	depends on SENSORS_SX9310
	tristate "SX9310 driver"
	default n
	help
	  Say Y here if you control grip power in cp.
	  Say N here if you do not use grip power in cp.

config SENSORS_SSP_NOBLELTE
	tristate "Sensors ssp for noble project"
	default n
	help
	  If you want to use noble project, it should be set.

config SENSORS_SSP_ZENLTE
	tristate "Sensors ssp for zen project"
	default n
	help
	  If you want to use zen project, it should be set.

config SENSORS_SSP_VLTE
	tristate "Sensors ssp for v project"
	default n
	help
	  If you want to use v project, it should be set.

source "drivers/sensorhub/stm/factory/Kconfig"
source "drivers/sensorhub/brcm/max_notchfilter/Kconfig"
```

## drivers/sensorhub/stm/factory/Kconfig
```kconfig
#
# sensor drivers configuration
#

config SENSORS_SSP_ATUC128L5HAR
	tristate "Sensors ssp atuc128l5har"
	default n
	depends on SPI
	help
	  atuc128l5har file for factory test in ssp driver.
          If you say yes here you get atuc128l5har support for
	  factory test.
	  To compile this driver as a module, choose M here: the
	  module will be called ssp.

config SENSORS_SSP_6AXIS
	tristate "Sensors ssp 6axis sensor"
	default n
	depends on SPI
	help
	  6axis sensor file for factory test in ssp driver.
          If you say yes here you get 6axis sensor support for
	  factory test.
	  To compile this driver as a module, choose M here: the
	  module will be called ssp.

config SENSORS_SSP_MPU6500
	tristate "Sensors ssp mpu6500"
	default n
	depends on SPI
	help
	  mpu6500 file for factory test in ssp driver.
          If you say yes here you get mpu6500 support for
	  factory test.
	  To compile this driver as a module, choose M here: the
	  module will be called ssp.

config SENSORS_SSP_BMI168
	tristate "Sensors ssp bmi168"
	default n
	depends on SPI
	help
	  bmi168 file for factory test in ssp driver.
          If you say yes here you get bmi168 support for
	  factory test.
	  To compile this driver as a module, choose M here: the
	  module will be called ssp.

config SENSORS_SSP_BMP280
	tristate "Sensors ssp bmp280"
	default n
	depends on SPI
	help
	  bmp182 file for factory test in ssp driver.
          If you say yes here you get bmp280 support for
	  factory test.
	  To compile this driver as a module, choose M here: the
	  module will be called ssp.

config SENSORS_SSP_TMD4903
	tristate "Sensors ssp tmd4903"
	default n
	depends on SPI
	help
	  tmd4903 file for factory test in ssp driver.
          If you say yes here you get tmd4903 support for
	  factory test.
	  To compile this driver as a module, choose M here: the
	  module will be called ssp.

config SENSORS_SSP_TMG399X
	tristate "Sensors ssp tmg399x"
	default n
	depends on SPI
	help
	  tmg399x file for factory test in ssp driver.
          If you say yes here you get tmg399x support for
	  factory test.
	  To compile this driver as a module, choose M here: the
	  module will be called ssp.

config SENSORS_SSP_AK09911
	tristate "Sensors ssp ak09911"
	default n
	depends on SPI
	help
	  ak09911 file for factory test and doeplus in ssp driver.
          If you say yes here you get ak09911 support for
	  factory test.
	  To compile this driver as a module, choose M here: the
	  module will be called ssp.

config SENSORS_SSP_MOBEAM
	tristate "Sensors ssp mobeam"
	default n
	depends on SPI
	help
	  mobeam file for ssp driver.
          If you say yes here you get mobeam support using TMG399x.
	  To compile this driver as a module, choose M here: the
	  module will be called ssp.
```

## drivers/sensorhub/stm/max_notchfilter/Kconfig
```kconfig
#
# sensor drivers configuration
#
config SENSORS_MAX_NOTCHFILTER
	tristate "Sensors Maxim Notch Filter"
	default n
	depends on SENSORS_MAX86902
	help
	  Max Notch filter file for HR test in sensor driver.
          If you say yes here you get Notch Filter support for
	  HR test.
	  To compile this driver as a module, choose M here: the
	  module will be called Max86902.
```

## drivers/soc/samsung/Kconfig
```kconfig
#
# EXYNOS Soc drivers
#
menuconfig SOC_SAMSUNG
	bool "SAMSUNG SOC drivers support"

if SOC_SAMSUNG
config EXYNOS_CHIPID
	bool "Exynos Chip ID Driver Support"
	depends on ARCH_EXYNOS
	select SOC_BUS
config EXYNOS_REBOOT
	bool "Exynos Chip Reboot Driver Support"
	depends on ARCH_EXYNOS

config SAMSUNG_DMADEV
	bool
	select ARM_AMBA
	select DMADEVICES
	select PL330_DMA if (ARCH_EXYNOS8)
	help
	  Use DMA device engine for PL330 DMAC.

config ECT
	bool "Enable Exynos Characteristic Table File"
	default n
	depends on ARCH_EXYNOS

config ECT_DUMP
	bool "Enable Exynos Characteristic Table File Dump sysfs"
	default n
	depends on ECT

config EXYNOS_CONTENT_PATH_PROTECTION
	bool "Exynos Content Path Protection"
	default y
	help
	  Enable content path protection of EXYNOS.

config EXYNOS_HOTPLUG_GOVERNOR
	bool "Enable Exynos dynamic hotplug governor"

config SCHED_HP_EVENT
	bool "Gathers scheduler events to decide hotplug in/out"
	depends on EXYNOS_HOTPLUG_GOVERNOR
	default y

config HP_EVENT_THREAD_GROUP
	bool "Gathres thread group information"
	depends on SCHED_HP_EVENT && SCHED_HMP
	default n

config HP_EVENT_HMP_SYSTEM_LOAD
	bool "Gathres system load information"
	depends on SCHED_HP_EVENT && SCHED_HMP
	default y

config EXYNOS_PM_DVS
	bool "Enable Exynos dynamic voltage setting"
	default n

config EXYNOS_OTP
	bool "Exynos OTP (one-time programmable) support"
	default n
	depends on ARCH_EXYNOS
	help
		This option enables OTP (one-time programmable) tune bits functions

config EXYNOS_MCINFO
	bool "Exynos memory controller information"
	default y

config MCINFO_SYSFS
	bool "Exynos memory controller information sysfs"
	depends on EXYNOS_MCINFO
	default	y if SYSFS

endif #SOC_SAMSUNG
```

## drivers/staging/samsung/Kconfig
```kconfig
# drivers/staging/samsung/Kconfig
#
# Copyright (c) 2010-2011 Samsung Electronics Co., Ltd.
#		http://www.samsung.com/
#
# Licensed under GPLv2

comment "Samsung TN Features"
config SEC_EXT
	bool "Samsung TN extension Feature"

config SEC_SYSFS
	bool "Samsung sec sysfs Feature"
	default y
	depends on SEC_EXT
	help
	  Samsung sysfs name 'sec' directory create.

config SEC_REBOOT
	bool "Samsung TM reboot extension Feature"
	default y
	depends on SEC_EXT
	help
	  Samsung TN reboot extension feature. Do additional work when reboot.

config SEC_MISC
        bool "Samsung TM Misc Feature"
        default n
        help
          Samsung TN Misc extension Feature. Do additional work when Misc.

config ARGOS
	bool "Throughput monitoring Feature"
	default n
	help
	  Check throughput and set appropriate system parameters(CPU freq, affinity, etc)

config SENTINEL
	bool "Memory Protection"
	default n
	help
	  Memory Protection

menuconfig SEC_DEBUG
	bool "Enable TN debugging features"
	depends on EXYNOS_SNAPSHOT && SEC_REBOOT
	default y

config SEC_DEBUG_RESET_REASON
	bool "Enable TN reset reason"
	depends on SEC_DEBUG
	default y
	help
	  This option enables storing reset reason history file
	  This option enables reading the reset reason history using proc/reset_reason file

config SEC_DEBUG_EXTRA_INFO
	bool "Enable TN reset reason extra info"
	depends on SEC_DEBUG && SEC_DEBUG_RESET_REASON
	default n
	help
	  This option enables storing reset reason extra info
	  This option enables ap reset info bigdata based on reset reason extra info

config SEC_DEBUG_HW_PARAM
	bool "Enable TN HW PARAM bigdata info"
	depends on SEC_DEBUG && SEC_DEBUG_RESET_REASON
	default n
	help
	  This option enables storing hw param bigdata info

config SEC_DEBUG_AUTO_SUMMARY
	bool "Enable TN kernel fault auto summary"
	depends on SEC_DEBUG
	default n
	help
	  This option enables kernel fault auto summary feature
	  This option also requires bootloader change that enables auto summary extraction along with ramdump

config SEC_DEBUG_LAST_KMSG
	bool "Write last_kmsg at /proc/last_kmsg"
	depends on SEC_DEBUG
	default y
	help
	  This option enables /proc/last_kmsg support.

config SEC_DEBUG_FILE_LEAK
	bool "Panic when file leak detected"
	depends on !SAMSUNG_PRODUCT_SHIP
	default y

config SEC_UPLOAD
	bool "Enable TN upload mode"
	depends on SEC_DEBUG
	default y
	help
	  Samsung TN upload mode

comment "Samsung TN BSP Options"
config SEC_PARAM
	bool "Enable Param modification"
	depends on SEC_DEBUG
	default n
	help
	  Samsung TN Param Feature.

config CM_OFFSET
	int "Charging Mode Offset"
	default 0
	depends on SEC_PARAM
	help
	  set Charging Mode Offset when you enable SEC_PARAM.

config SEC_FACTORY
	bool "SAMSUNG Factory build option"
	default n
	select SEC_PANIC_PCIE_ERR
	help
	  Include some codes for Factory binary.

config SEC_HOTPLUG
	bool "Control cpu qos for samsung feature"
	default y
	depends on SENSORS_FP_LOCKSCREEN_MODE
	help
	  Request wakeup with big core for samsung fingerprint

comment "Samsung TN logging feature"
config SEC_AVC_LOG
	default n
	bool "Enable avc audit log support" if EMBEDDED
	depends on SEC_EXT
	help
	  This option enables additional log buffer for audit log.

config SEC_DEBUG_TSP_LOG
	default n
	bool "Enable tsp log support" if EMBEDDED
	depends on SEC_EXT
	help
	  This option enables additional log buffer for tsp log.

comment "Samsung TN Power Management Options"
menuconfig SEC_PM
	bool "Samsung TN Power Management"
	default y
	help
	  Samsung TN Power Management.

config SEC_PM_DEBUG
	bool "Enable Samsung TN Power management debug support"
	default y
	depends on SEC_PM
	help
	  Enable Samsung TN Power management debug support.

comment "BSP Feature"
menuconfig SEC_BSP
	bool "Samsung TN BSP Feature"
	default n
	depends on SEC_EXT
	help
	  Samsung TN BSP Feature.

config SEC_INITCALL_DEBUG
	bool "Enable Samsung initcall debug support"
	default n
	depends on SEC_DEBUG && !SAMSUNG_PRODUCT_SHIP
	help
	  Enable Samsung initcall debug support.
  
config SEC_NAD
	bool "Samsung TN NAD Feature"
	default n
	help
	  Samsung TN NAD Feature, support AT CMD for NAD 2.0

config SEC_NAD_API
	bool "Samsung TN NAD API Feature"
	depends on SEC_NAD
	default n
	help
	  Samsung TN NAD Feature, Support NAD API to check gpio pull-up registance

config SEC_NAD_MANUAL_PARAM_READTIME
	int "Samsung TN NAD Feature"
	depends on SEC_NAD
	default "10"
	help
	  Samsung TN NAD Feature, set param reading time manually.

config SEC_EVENT_LOG
	bool "Enable Event log parser"
	depends on SEC_EXT
	default n

config BOOTING_VALIDATION
	bool "Enable checking validation of booting"
	depends on SEC_DEBUG
	default n
```
