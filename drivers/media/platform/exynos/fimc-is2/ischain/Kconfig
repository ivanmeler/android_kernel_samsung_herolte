## drivers/muic/Kconfig
```kconfig
#
# MUIC devices
#

comment "MUIC configs"

config USE_MUIC
	bool "Using MUIC device driver"
	depends on I2C
	default n
	help
	  If you say yes here you will get support for
	  the MUIC device driver.

config USE_SAFEOUT
	bool "Using SAFEOUT device driver"
	depends on I2C
	default n
	help
	  If you say yes here you will get support for
	  the SAFEOUT device driver.

config MUIC_NOTIFIER
	bool "MUIC notifier support"
	depends on USE_MUIC
	default n
	help
	  If you say yes here you will get support for
	  the MUIC attached device status change notification.

config MUIC_MAX77833
        bool "Using MAX77833 MUIC"
        depends on MFD_MAX77833 && USE_MUIC
        default n
        help
          If you say yes here you will get support for 
          for the MAX77833 MUIC chip.

config HV_MUIC_MAX77833_AFC
        bool "Using MAX77833 AFC MUIC"
        depends on MUIC_MAX77833
        default n
        help
          If you say yes here you will get support for the MAX77833 AFC MUIC.

config MUIC_MAX77833_SHAKEID_WA
        bool "Using MAX77833 MUIC SHAKE ID WA"
        depends on MUIC_MAX77833
        default n
        help
          If you say yes here you will get support for the MAX77833 MUIC SHAKE ID WA.

config MUIC_MAX77833_IGNORE_ADCERR_WA
        bool "Using MAX77833 MUIC ignore ADCERR WA"
        depends on MUIC_MAX77833
        default n
        help
          If you say yes here you will get support for the MAX77833 MUIC RESET WA. 

config MUIC_MAX77833_RESET_WA
        bool "Using MAX77833 MUIC RESET WA"
        depends on MUIC_MAX77833
        default n
        help
          If you say yes here you will get support for the MAX77833 MUIC RESET WA.

config MUIC_UNIVERSAL
	bool "UNIVERSAL MUIC"
	depends on USE_MUIC
	default n
	help
	  If you say yes here you will get support for various MUIC chips.

config MUIC_UNIVERSAL_MAX77854
	bool "MAX77854 MUIC"
	depends on MUIC_UNIVERSAL
	default n
	help
	  If you say yes here you will get support for the MAX77854 MUIC chip.

config MUIC_HV
	bool "MUIC_HV"
	depends on MUIC_UNIVERSAL
	default n
	help
	  If you say yes here you will get support for the AFC.

config MUIC_HV_12V
	bool "MUIC_HV_12V"
	depends on MUIC_HV
	default n
	help
	  If you say yes here you will get support for the AFC.

config MUIC_SUPPORT_CCIC
	bool "MUIC supports CCIC chip interface"
	depends on MUIC_UNIVERSAL
	default n
	help
	  If you say yes here you will get support for the CCIC chip.

config MUIC_HV_SUPPORT_POGO_DOCK
	bool "MUIC_HV_SUPPORT_POGO_DOCK"
	depends on MUIC_HV
	default n
	help
	  If you say yes here you will get support for the AFC pogo dock.

config HICCUP_CHARGER
	bool  "Using HICCUP charger"
	depends on USE_MUIC && !SEC_FACTORY
	default n
	help
	  If you say yes here you will get support for the hiccup charger.
```

## drivers/net/wireless/bcmdhd4358/Kconfig
```kconfig
config BROADCOM_WIFI
	bool "Broadcom WiFi Driver"
	depends on WLAN
	default n
	---help---
	  This is a configuration for broadcom WLAN driver.

config BCM4330
	tristate "Broadcom 4330 wireless cards support"
	depends on BROADCOM_WIFI
	---help---
	  This module adds support for wireless adapters based on
	  Broadcom 4330 chipset.

config BCM4343
	tristate "Broadcom 4343 wireless cards support"
	depends on BROADCOM_WIFI
	---help---
	  This module adds support for wireless adapters based on
	  Broadcom 4343 chipset.

config BCM4334
	tristate "Broadcom 4334 wireless cards support"
	depends on BROADCOM_WIFI
	---help---
	  This module adds support for wireless adapters based on
	  Broadcom 4334 chipset.

config BCM4335
	tristate "Broadcom 4335 wireless cards support"
	depends on BROADCOM_WIFI
	---help---
	  This module adds support for wireless adapters based on
	  Broadcom 4335 chipset.

config BCM4339
	tristate "Broadcom 4339 wireless cards support"
	depends on BROADCOM_WIFI
	---help---
	  This module adds support for wireless adapters based on
	  Broadcom 4339 chipset.

config BCM4354
	tristate "Broadcom 4354 wireless cards support"
	depends on BROADCOM_WIFI
	---help---
	  This module adds support for wireless adapters based on
	  Broadcom 4354 chipset.

config BCM4358
	tristate "Broadcom 4358 wireless cards support"
	depends on BROADCOM_WIFI
	---help---
	  This module adds support for wireless adapters based on
	  Broadcom 4358 chipset.

config BCM4358_A3
	tristate "Broadcom 4358 wireless cards support"
	depends on BROADCOM_WIFI
	---help---
	  This module adds support for wireless adapters based on
	  Broadcom 4358 chipset.

config BCM43241
	tristate "Broadcom 43241 wireless cards support"
	depends on BROADCOM_WIFI
	---help---
	  This module adds support for wireless adapters based on
	  Broadcom 43241 chipset.

config BCMDHD_FW_PATH
	depends on BROADCOM_WIFI
	string "Firmware path"
	default "/system/etc/firmware/fw_bcmdhd.bin"
	---help---
	  Path to the firmware file.

config BCMDHD_NVRAM_PATH
	depends on BROADCOM_WIFI
	string "NVRAM path"
	default "/system/etc/wifi/bcmdhd.cal"
	---help---
	  Path to the calibration file.

config BROADCOM_WIFI_RESERVED_MEM
	bool "BROADCOM Reserved memory for wifi device"
	depends on BROADCOM_WIFI
	---help---
	  This is a configuration for broadcom WLAN driver.

config BCM4335BT
	bool "BROADCOM BTLOCK Enable"
	depends on BCM4335
	default y
	---help---
	  This is a configuration for bt lock enable.

config WLAN_REGION_CODE
	int "---Region codes for Broadcom WiFi Driver"
	depends on BROADCOM_WIFI
	default 100
	---help---
		This is a region code for Broadcom Wi-Fi featured functions.
		- 100 : EUR OPEN
		- 101 : EUR ORG
		- 200 : KOR OPEN
		- 201 : KOR SKT
		- 202 : KOR KTT
		- 203 : KOR LGT
		- 300 : CHN OPEN

config WLAIBSS
	bool "Advanced IBSS mode"
	depends on (BCM4335 || BCM4339 || BCM4354 || BCM4358)
	default y
	---help---
	  This is a configuration for Oxygen Network.

config WL_NAN
	bool "NAN Feature"
	depends on (BCM4354 || BCM4358)
	default n
	---help---
	  This is a configuration for NAN Feature.

config BCMDHD_PCIE
	bool "Enable PCIe I/F Support"
	depends on (BCM4354 || BCM4358)
	---help---
	  Enable PCI Express I/F Support

config BCMDHD_DEBUG_PAGEALLOC
	bool "Enable Memory Pagealloc Debugging Support"
	depends on (BCM4354 || BCM4358)
	---help---
	  Enable Memory Pagealloc Debugging

config BCMDHD_PREALLOC_MEMDUMP
	bool "BROADCOM PCIE specific memory reserved for MEMDUMP"
	depends on BROADCOM_WIFI_RESERVED_MEM
	---help---
	  Preallocated memory support for dongle memory dump

config WIFI_BROADCOM_COB
        bool "BROADCOM COB type chip is enabled"
        depends on BROADCOM_WIFI
        ---help---
          This is a configuration for broadcom WIFI COB type.

config SPLIT_ARGOS_SET
	bool "Support argos table"
	depends on BROADCOM_WIFI
	---help---
	To support SPLIT_ARGOS_SET 
```

## drivers/nfc/Kconfig
```kconfig
#
# Near Field Communication (NFC) devices
#

menu "Near Field Communication (NFC) devices"
	depends on NFC

config SEC_NFC
	bool "Samsung NFC driver"
	default n
	help
	  SAMSUNG NFC Driver.
	  This driver provides support for SAMSUNG NFC products.
	  You should select your NFC product and interface.

	  Say Y here to compile support for SAMSUNG NFC driver into the
	  kernel.

config ESE_P3_LSI
	bool "Oberthur ese driver"
	depends on SPI
	default n
	help
	  Oberthur Driver.
	  This driver provides support for LSI NXP combined ESE products.
	  You should select your NFC product and interface.

config ESE_FACTORY_ONLY
	bool "Oberthur ese driver factory"
	depends on SPI
	default n
	help
	  Oberthur Driver.
	  This driver provides support for LSI NXP combined ESE products.
	  You should select your NFC product and interface.

config NFC_PN547
	bool "NXP PN547 NFC Controller Driver"
	depends on I2C
	default n
	help
	  NXP PN547 Near Field Communication controller support.
	  This option enables device driver support for the NFC.
	  It is used by many services. NFC is fully controlled using I2C
	  to communication.

config NFC_PN547_CLK_BBCLK2
	bool "NXP PN547 NFC CLOCK Controller"
	depends on NFC_PN547
	default n
	help
	  NXP PN547 Near Field Communication controller support.
	  This option enables device driver support for the NFC.
	  It is used by many services. NFC is fully controlled using I2C
	  to communicate the AP chip.

config NFC_P61
	bool "NXP PN547 NFC Controller Driver"
	depends on SPI
	default n
	help
	  NXP PN547 Near Field Communication controller support.
	  This option enables device driver support for the NFC.
	  It is used by many services. NFC is fully controlled using I2C
	  to communication

config ESE_SECURE
	bool "ESE Secure Controller Driver"
	depends on SPI
	default n
	help
	  Common eSE Secure controller support.
	  This option enables device driver support for the eSE with NFC.
	  It is used by many services. eSE is fully controlled using SPI
	  to communication

config ESE_SECURE_SPI_PORT
	int "ese spi port number"
	default	99

config ESE_SECURE_GPIO
	string "gpio group for ese"

config ESE_COFFEE
	bool "ESE Secure Controller Driver"
	depends on SPI
	default n
	help
	  Common eSE Secure controller support.
	  This option enables device driver support for the eSE with NFC.
	  It is used by many services. eSE is fully controlled using SPI
	  to communication

config NFC_PN547_ESE_SUPPORT
	bool "NXP PN547 ESE SUPPORT"
	depends on NFC_PN547
	default n
	help
	  NXP PN547 Near Field Communication controller support.
	  This option enables device driver support for the NFC.
	  It is used by many services. NFC is fully controlled using I2C
	  to communication

config NFC_PN547_LDO_CONTROL
	bool "PN547 NFC LDO CONTROL"
	depends on NFC_PN547
	default n
	help
	  SAMSUNG PN547 NFC LDO CONTROL feature.
	  This feature provides support for NXP PN547 products.
	  You should select this feature if your NFC product uses ldo control of i2c.

	  Say Y here to compile support for NXP PN547 LDO CONTROL feature into the
	  kernel.

config NFC_CLKREQ_SUSPEND
	bool "SEC NFC driver"
	depends on SEC_NFC
	default n
	help
	  SEC NFC Driver.
	  This can be used when it needs to observe NFC_CLK_REQ pin at suspend.

source "drivers/nfc/secnfc/Kconfig"

endmenu
```

## drivers/nfc/secnfc/Kconfig
```kconfig
#
# Samsung System LSI - Near Field Communication (NFC) devices
#

config SEC_NFC_SENN3AB
    bool "Samsung NFC driver"
    default n
    help
      SAMSUNG NFC Driver.
      This driver provides support for SAMSUNG NFC products.
      You should select your NFC product and interface.

      Say Y here to compile support for SAMSUNG NFC driver into the
      kernel.


config SEC_NFC_SENN3AB_FN
    bool "SENN3AB_FN"
    depends on SEC_NFC_SENN3AB
    default n
    help
      SAMSUNG NFC Driver for Felica Networks.
      This driver provides support for SAMSUNG NFC products.
      You should select your NFC product and interface.

      Say Y here to compile support for SAMSUNG NFC driver for into the
      kernel.

config NFC_DEBUG
	bool "NFC debug enable"
	default n
	help
      SAMSUNG NFC Driver debug support for Felica Networks.
      This driver provides support for debugging SAMSUNG NFC driver.
      You should select your NFC product and interface.

	  Say Y here to enable debugging support for the SAMSUNG NFC drivers.
config SEC_NFC_LDO_JPN_CONTROL
	bool "SEC NFC LDO JPN CONTROL"
	depends on SEC_NFC_SENN3AB
	default n
	help
	  SAMSUNG SEC NFC LDO CONTROL feature.
	  This feature provides support for SAMSUNG NFC products.
	  You should select this feature if your NFC product uses ldo control of i2c.

	  Say Y here to compile support for SEC NFC LDO CONTROL feature into the
	  kernel.

config NFC_EDC_TUNING
        bool "NFC_EDC_TUNING"
        default n
        help
          SAMSUNG SEC NFC EDC TUNNING feature.
          This feature provides support for SAMSUNG NFC products.
	  You should select this feature if you want to change EDC value for view cover.

	  Say Y here to improve view cover recognition rate
```
