## drivers/media/platform/exynos/fimc-is2/ischain/Kconfig
```kconfig
config EXYNOS_FIMC_IS
        bool "Use FIMC-IS"
        depends on VIDEO_EXYNOS_FIMC_IS2
        default y
        help
          fimc-is

source "drivers/media/platform/exynos/fimc-is2/ischain/fimc-is-v4_3_0/Kconfig"
source "drivers/media/platform/exynos/fimc-is2/ischain/fimc-is-v4_0_0/Kconfig"
source "drivers/media/platform/exynos/fimc-is2/ischain/fimc-is-v3_1_1/Kconfig"
source "drivers/media/platform/exynos/fimc-is2/ischain/fimc-is-v3_11_0/Kconfig"
```

## drivers/media/platform/exynos/fimc-is2/ischain/fimc-is-v3_11_0/Kconfig
```kconfig
config FIMC_IS_V3_11_0
	bool "Use fimc-is v3.11.0"
	depends on EXYNOS_FIMC_IS
	default n
	help
	  fimc-is version 3.11.0
```

## drivers/media/platform/exynos/fimc-is2/ischain/fimc-is-v3_1_1/Kconfig
```kconfig
config FIMC_IS_V3_1_1
	bool "Use fimc-is v3.1.1"
	depends on EXYNOS_FIMC_IS
	default n
	help
	  fimc-is version 3.1.1
```

## drivers/media/platform/exynos/fimc-is2/ischain/fimc-is-v4_0_0/Kconfig
```kconfig
config FIMC_IS_V4_0_0
	bool "Use fimc-is v4.0.0"
	depends on EXYNOS_FIMC_IS
	default n
	help
	  fimc-is version 4.0.0
```

## drivers/media/platform/exynos/fimc-is2/ischain/fimc-is-v4_3_0/Kconfig
```kconfig
config FIMC_IS_V4_3_0
	bool "Use fimc-is v4.3.0"
	depends on EXYNOS_FIMC_IS
	default n
	help
	  fimc-is version 4.3.0
```

## drivers/media/platform/exynos/fimc-is2/sensor/Kconfig
```kconfig
config EXYNOS_CAMERA_MODULE
	bool "Use Modules"
	depends on VIDEO_EXYNOS_FIMC_IS2
	default y
	help
	  moduels

source "drivers/media/platform/exynos/fimc-is2/sensor/module/Kconfig"

config EXYNOS_MIPI_CSIS
        bool "Use MIPI-CSIS"
        depends on VIDEO_EXYNOS_FIMC_IS2
        default y
        help
          This is a v4l2 driver for exynos FIMC-IS device.

config EXYNOS_DEVICE_MIPI_CSIS
	bool "Use Device MIPI-CSIS Legacy"
	depends on EXYNOS_MIPI_CSIS
	default n
	help
	  Enalbe Device MIPI-CSIS Legacy

source "drivers/media/platform/exynos/fimc-is2/sensor/csi/Kconfig"

config EXYNOS_DEVICE_MIPI_CSIS_VER2
	bool "Use Device MIPI-CSIS Version 2"
	depends on EXYNOS_MIPI_CSIS
	default n
	help
	  Enalbe Device MIPI-CSIS Version 2(Including WDMA)

source "drivers/media/platform/exynos/fimc-is2/sensor/csi2/Kconfig"

config EXYNOS_FIMC_BNS
        bool "Use FIMC_BNS(LITE)"
        depends on VIDEO_EXYNOS_FIMC_IS2
        default y
        help
          This is a v4l2 driver for exynos FIMC-IS device.

source "drivers/media/platform/exynos/fimc-is2/sensor/flite/Kconfig"

source "drivers/media/platform/exynos/fimc-is2/sensor/module_framework/Kconfig"
source "drivers/media/platform/exynos/fimc-is2/sensor/module_framework/cis/Kconfig"
source "drivers/media/platform/exynos/fimc-is2/sensor/module_framework/actuator/Kconfig"
source "drivers/media/platform/exynos/fimc-is2/sensor/module_framework/flash/Kconfig"
source "drivers/media/platform/exynos/fimc-is2/sensor/module_framework/dphy/Kconfig"
```

## drivers/media/platform/exynos/fimc-is2/sensor/csi/Kconfig
```kconfig
config CSIS_V3_2
        bool "Use csi v3.2"
        depends on EXYNOS_DEVICE_MIPI_CSIS
        default n
        help
          csi version 3.2

config CSIS_V3_4
        bool "Use csi v3.4"
        depends on EXYNOS_DEVICE_MIPI_CSIS
        default n
        help
          csi version 3.4
```

## drivers/media/platform/exynos/fimc-is2/sensor/csi2/Kconfig
```kconfig
config CSIS_V4_0
	bool "Use csi v4.0"
        depends on EXYNOS_DEVICE_MIPI_CSIS_VER2
	default n
	select USE_CSI_DMAOUT_FEATURE
	help
	  csi version 4.0

config CSIS_V4_1
	bool "Use csi v4.1"
        depends on EXYNOS_DEVICE_MIPI_CSIS_VER2
	default n
	select USE_CSI_DMAOUT_FEATURE
	help
	  csi version 4.1

config USE_CSI_DMAOUT_FEATURE
	bool "Use csi dmaout feature"
        depends on CSIS_V4_0 || CSIS_V4_1
	default n
	help
	  csi dmaout feature
```

## drivers/media/platform/exynos/fimc-is2/sensor/flite/Kconfig
```kconfig
config FIMC_BNS_V2_0
	bool "Use bns v2.0 (Exynos7420)"
	depends on EXYNOS_FIMC_BNS
	default n
	help
	  bns version 3.0

config FIMC_BNS_V4_0
	bool "Use bns v4.0 (Exynos8890)"
	depends on EXYNOS_FIMC_BNS
	default n
	help
	  bns version 4.0

config FIMC_BNS_V4_10_0
	bool "Use bns v4.10.0 (Exynos7870)"
	depends on EXYNOS_FIMC_BNS
	default n
	help
	  bns version 4.10.0

config FIMC_BNS_V4_20_0
	bool "Use bns v4.20.0 (Exynos8890 EVT1)"
	depends on EXYNOS_FIMC_BNS
	default n
	help
	  bns version 4.20.0
```

## drivers/media/platform/exynos/fimc-is2/sensor/module_framework/actuator/Kconfig
```kconfig
menuconfig CAMERA_ACT_SELECT
	bool "Sensor actuator select"
	depends on USE_DIRECT_IS_CONTROL
	help
	  Say Y here to enable support for platform-specific V4L drivers.

config CAMERA_ACT_AK7348_OBJ
        bool "Use actuator AK7348"
	depends on USE_DIRECT_IS_CONTROL
	depends on CAMERA_ACT_SELECT
        default n
        help
          Use to build AK7348 driver.

config CAMERA_ACT_AK7345_OBJ
        bool "Use actuator AK7345"
	depends on USE_DIRECT_IS_CONTROL
	depends on CAMERA_ACT_SELECT
        default n
        help
          Use to build AK7345 driver.

config CAMERA_ACT_DW9714_OBJ
        bool "Use actuator DW9714"
	depends on USE_DIRECT_IS_CONTROL
	depends on CAMERA_ACT_SELECT
        default n
        help
          Use to build DW9714 driver.

config CAMERA_ACT_DW9804_OBJ
        bool "Use actuator DW9804"
	depends on USE_DIRECT_IS_CONTROL
	depends on CAMERA_ACT_SELECT
        default n
        help
          Use to build DW9804 driver.
```

## drivers/media/platform/exynos/fimc-is2/sensor/module_framework/cis/Kconfig
```kconfig
menuconfig CAMERA_CIS_SELECT
	bool "Sensor cis select"
	depends on USE_DIRECT_IS_CONTROL
	help
	  Say Y here to enable support for platform-specific V4L drivers.

config CAMERA_CIS_6B2_OBJ
        bool "Use 6B2 camera cis"
	depends on USE_DIRECT_IS_CONTROL
	depends on CAMERA_CIS_SELECT
        default n
        help
          Use to build 6B2 camera sensor.

config CAMERA_CIS_5E2_OBJ
        bool "Use 5E2 camera cis"
	depends on USE_DIRECT_IS_CONTROL
	depends on CAMERA_CIS_SELECT
        default n
        help
          Use to build 5E2 camera sensor.

config CAMERA_CIS_4H5YC_OBJ
        bool "Use 4H5YC camera cis"
	depends on USE_DIRECT_IS_CONTROL
	depends on CAMERA_CIS_SELECT
        default n
        help
          Use to build 4H5YC camera sensor.

config CAMERA_CIS_4H5_OBJ
        bool "Use 4H5 camera cis"
	depends on USE_DIRECT_IS_CONTROL
	depends on CAMERA_CIS_SELECT
        default n
        help
          Use to build 4H5 camera sensor.

config CAMERA_CIS_2P2_OBJ
		bool "Use 2P2 camera cis"
	depends on USE_DIRECT_IS_CONTROL
	depends on CAMERA_CIS_SELECT
		default n
		help
		  Use to build 2P2 camera sensor.
config CAMERA_CIS_2P8_OBJ
		bool "Use 2P8 camera cis"
	depends on USE_DIRECT_IS_CONTROL
	depends on CAMERA_CIS_SELECT
		default n
		help
		  Use to build 2P8 camera sensor.
```

## drivers/media/platform/exynos/fimc-is2/sensor/module_framework/flash/Kconfig
```kconfig
menuconfig CAMERA_FLASH_SELECT
	bool "Sensor flash select"
	depends on USE_DIRECT_IS_CONTROL
	help
	  Say Y here to enable support for platform-specific V4L drivers.

config CAMERA_FLASH_LM3560_OBJ
        bool "Use LM3560"
	depends on USE_DIRECT_IS_CONTROL
	depends on CAMERA_FLASH_SELECT
        default n
        help
          Use to build LM3560 driver.

config CAMERA_FLASH_RT5033_OBJ
        bool "Use RT5033"
	depends on USE_DIRECT_IS_CONTROL
	depends on CAMERA_FLASH_SELECT
        default n
        help
          Use to build RT5033 driver.
```

## drivers/media/platform/exynos/fimc-is2/vendor/Kconfig
```kconfig
config VENDER_FEATURE
        bool "Use vendor specific features"
        depends on VIDEO_EXYNOS_FIMC_IS2
        default y
        help
          Use the vender specfic features.

config VENDER_DEFAULT
        bool "Use DEFAULT vender"
        depends on VENDER_FEATURE
        default n
        help
          Default.

source "drivers/media/platform/exynos/fimc-is2/vendor/default/Kconfig"

config VENDER_MCD
        bool "Use MCD vender"
        depends on VENDER_FEATURE
        default n
        help
          MCD.

source "drivers/media/platform/exynos/fimc-is2/vendor/mcd/Kconfig"
```

## drivers/media/platform/exynos/fimc-is2/vendor/mcd/Kconfig
```kconfig
config CAMERA_EEPROM_SUPPORT_REAR
        bool "Enable eeprom for rear cam"
        depends on VENDER_MCD
        default n
        help
          Enable eeprom for rear cam.
config CAMERA_EEPROM_SUPPORT_FRONT
        bool "Enable eeprom for front cam"
        depends on VENDER_MCD
        default n
        help
          Enable eeprom for front cam.
config COMPANION_USE
        bool "Use companion"
        depends on VENDER_MCD
        default n
        help
          Use companion.
 config COMPANION_C1_USE
        bool "Use companion C1"
        depends on VENDER_MCD
        default n
        help
          Use companion C1.
 config COMPANION_C2_USE
        bool "Use companion C2"
        depends on VENDER_MCD
        default n
        help
          Use companion C2.
 config COMPANION_C3_USE
        bool "Use companion C3"
        depends on VENDER_MCD
        default n
        help
          Use companion C3.
config COMPANION_DCDC_USE
        bool "Use companion DCDC regulator"
        depends on VENDER_MCD
        default n
        help
          Use companion DCDC regulator.
config PREPROCESSOR_STANDBY_USE
        bool "Use companion standby"
        depends on VENDER_MCD
        default n
        help
          Use companion standby.
config SENSOR_RETENTION_USE
	bool "Use sensor retention"
	depends on VENDER_MCD
	default n
	help
	  Use sensor retention.
config OIS_USE
        bool "Use ois"
        depends on VENDER_MCD
        default n
        help
          Use ois.
config OIS_FW_UPDATE_THREAD_USE
        bool "Enable ois fw update thread"
        depends on OIS_USE
        default n
        help
          Enable ois fw update thread.
config AF_HOST_CONTROL
        bool "Enable host af control"
        depends on VENDER_MCD
        default n
        help
          Enable host af control.
config TORCH_CURRENT_CHANGE_SUPPORT
        bool "Change torch current in recording mode"
        depends on VENDER_MCD
        default n
        help
          Change torch current in recording mode.
config CAMERA_HERO
        bool "This camera is hero project"
        depends on VENDER_MCD
        default n
        help
          This camera is hero project.
config CAMERA_GRACE
        bool "This camera is grace project"
        depends on VENDER_MCD
        default n
        help
          This camera is grace project.
config CAMERA_VJFLTE
        bool "This camera is vjflte project"
        depends on VENDER_MCD
        default n
        help
          This camera is vjflte project.
config CAMERA_ULTE
        bool "This camera is ulte project"
        depends on VENDER_MCD
        default n
        help
          This camera is ulte project.
config OIS_USE_RUMBA_S4
        bool "Use RUMBA S4 ois driver IC"
        depends on OIS_USE
        default n
        help
          Use RUMBA S4 ois driver IC.
config COMPANION_FACTORY_VALIDATION
        bool "Use factory validation for companion ic"
        depends on COMPANION_USE
        default n
        help
          Use factory validation for companion ic.
config SECURE_CAMERA_USE
        bool "Use secure camera"
        depends on VENDER_MCD
        default n
        help
          Use secure camera.
```

## drivers/media/platform/exynos/fimg2d_v5/Kconfig
```kconfig
#
# Copyright (c) 2015 Samsung Electronics Co., Ltd.
#		http://www.samsung.com/
#
# Licensed under GPLv2

config VIDEO_EXYNOS_FIMG2D_V5
	bool "Samsung Graphics 2D Driver v5"
	depends on VIDEO_EXYNOS && ARCH_EXYNOS8
	default n
	---help---
	  This is a legacy driver for graphics 2D in Samsung ARM based SoC.

config FIMG2D_CCI_SNOOP
	bool
	depends on VIDEO_EXYNOS_FIMG2D_LEGACY
	default n

choice
depends on VIDEO_EXYNOS_FIMG2D_V5
prompt "FIMG2D version"
	default VIDEO_EXYNOS_FIMG2D_LEGACY
config VIDEO_EXYNOS_FIMG2D_LEGACY
prompt "G2D legacy version"
	bool
	select FIMG2D_CCI_SNOOP
config VIDEO_EXYNOS_FIMG2D_1SHOT2
prompt "G2D m2m1shot2 version"
	bool
	select MEDIA_M2M1SHOT2
endchoice
```

## drivers/media/platform/exynos/hevc/Kconfig
```kconfig
config VIDEO_EXYNOS_HEVC
	bool "Exynos HEVC Driver"
	default n
	depends on VIDEO_EXYNOS
	select VIDEOBUF2_CORE
	select EXYNOS_HEVC_V1
	---help---
	  HEVC driver for V4L2.
```

## drivers/media/platform/exynos/mfc/Kconfig
```kconfig
config VIDEO_EXYNOS_MFC
	bool "Exynos MFC Driver"
	default n
	depends on VIDEO_EXYNOS
	select VIDEOBUF2_CORE
	select EXYNOS_MFC_V10
	---help---
	  MFC driver for V4L2.

choice
depends on VIDEO_EXYNOS_MFC
prompt "MFC version"
default EXYNOS_MFC_V10
config EXYNOS_MFC_V10
prompt "MFC version 10"
	bool
	depends on ARCH_EXYNOS8
endchoice
```

## drivers/media/platform/exynos/scaler/Kconfig
```kconfig
config VIDEO_EXYNOS_SCALER
	bool "EXYNOS Scaler Driver"
	depends on VIDEO_EXYNOS
	select V4L2_MEM2MEM_DEV
	select MEDIA_M2M1SHOT
	select VIDEOBUF2_ION
	default n
	help
	  This is a v4l2 driver for EXYNOS Scaler (MSCL) device.

config SCALER_NO_SOFTRST
	bool "Ignore SOFT_RESET control"
	depends on VIDEO_EXYNOS_SCALER
	default n
	---help---
	  This disables SOFT_RESET control for Exynos Scaler initial settings.
```

## drivers/media/platform/exynos/smfc/Kconfig
```kconfig
config VIDEO_EXYNOS_SMFC
	bool "Exynos Still MFC(H/W JPEG CODEC) Driver"
	depends on VIDEO_EXYNOS
	select V4L2_MEM2MEM_DEV
	select VIDEOBUF2_ION
	default n
	help
	  Still MFC(Multi Format Codec) V4L2 Driver for Exynos SoCs.
	  The driver supports for mem2mem V4L2 device.
```

## drivers/media/tdmb/Kconfig
```kconfig
#
# TDMB config states
#

#klaatu TDMB
config TDMB
	bool "T-DMB"
	help
	  This allows T-DMB support for Korea.
	  This module is designed for SPI or EBI2.
	  Select chipset and interface

	config TDMB_VENDOR_FCI
	depends on TDMB
	bool "FCI"

choice
	depends on TDMB && TDMB_VENDOR_FCI
	prompt "chip"
	default TDMB_FC8080
	config TDMB_FC8050
		bool "FC8050"
	config TDMB_FC8080
		bool "FC8080"
endchoice

config TDMB_VENDOR_INC
	depends on TDMB
	bool "I&C"

choice
	depends on TDMB && TDMB_VENDOR_INC
	prompt "chip"
	default TDMB_T39F0
	config TDMB_T39F0
		bool "T39F0"
	config TDMB_T3900
		bool "T3900"
	config TDMB_T3700
		bool "T3700"
	config TDMB_T3300
		bool "T3300"
endchoice

config TDMB_VENDOR_RAONTECH
	depends on TDMB
	bool "Raontech"

choice
	depends on TDMB && TDMB_VENDOR_RAONTECH
	prompt "chip"
	default TDMB_MTV318
	config TDMB_MTV318
		bool "MTV318"
	config TDMB_MTV319
		bool "MTV319"
endchoice

config TDMB_VENDOR_TELECHIPS
	depends on TDMB
	bool "Telechips"

choice
	depends on TDMB && TDMB_VENDOR_TELECHIPS
	prompt "chip"
	default TDMB_TCC3170
	config TDMB_TCC3170
		bool "TCC3170"
endchoice

choice
	depends on TDMB
	prompt "AP vendor"
	default TDMB_QUALCOMM
	config TDMB_QUALCOMM
		bool "Qualcomm"
	config TDMB_SLSI
		bool "S.LSI"
endchoice

config TDMB_SPI
	depends on TDMB
	bool "SPI"

config TDMB_EBI
	depends on TDMB
	bool "EBI"
config TDMB_TSIF_SLSI
	depends on TDMB
	bool "SLSI TSIF"
config TDMB_TSIF_QC
	depends on TDMB
	bool "Qualcomm TSIF"

config TDMB_I2C
	depends on TDMB
	bool "I2C"

config TDMB_XTAL_FREQ
	depends on TDMB
	bool "use xtal freq"
	default 0

config TDMB_DEBUG
	depends on TDMB
	bool "tdmb debugfs"

config TDMB_ANT_DET
	depends on TDMB
	bool "tdmb antenna detector"

config TDMB_VREG_SUPPORT
	depends on TDMB
	bool "tdmb use regulator vdd"
```

## drivers/motor/Kconfig
```kconfig
config MOTOR_DRV_MAX77854
	tristate "Maxim MAX77854 motor"
	default n
	depends on (MFD_MAX77854 && ANDROID_TIMED_OUTPUT)
	help
	  If you say yes here you will get support for the
	  motor of Maxim MAX77854 PMIC.

config MOTOR_DRV_SENSOR
	tristate "Maxim MAX77854 motor"
	default n
	depends on MFD_MAX77854
	help
	  Say Y to enable MOTOR DRV SENSOR.
	  
```
