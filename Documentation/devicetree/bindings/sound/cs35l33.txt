## drivers/gpu/arm/t8xx/r12p0/Kconfig
```kconfig
#
# (C) COPYRIGHT 2012-2015 ARM Limited. All rights reserved.
#
# This program is free software and is provided to you under the terms of the
# GNU General Public License version 2 as published by the Free Software
# Foundation, and any use by you of this program is subject to the terms
# of such GNU licence.
#
# A copy of the licence is included with the program, and can also be obtained
# from Free Software Foundation, Inc., 51 Franklin Street, Fifth Floor,
# Boston, MA  02110-1301, USA.
#
#

# MALI_SEC_INTEGRATION
# To resolve the choice error in Kconfig,
# move the config selection to Kbulid.
#
# choice
#	prompt "Streamline support"
#	depends on MALI_R12P0
#	default MALI_TIMELINE_DISABLED
#	help
#	  Select streamline support configuration.
#
# config MALI_TIMELINE_DISABLED
#	bool "Streamline support disabled"
#	depends on MALI_R12P0
#	help
#	  Disable support for ARM Streamline Performance Analyzer.
#
#	  Timeline support will not be included in
#	  kernel code.
#	  Debug stream will not be generated.
#
# config MALI_GATOR_SUPPORT_TIMELINE
#	bool "Streamline support via Gator"
#	default n
#	depends on MALI_R12P0
#	help
#	  Adds diagnostic support for use with the ARM Streamline Performance Analyzer.
#	  You will need the Gator device driver already loaded before loading this driver when enabling
#	  Streamline debug support.
#
# config MALI_MIPE_ENABLED
#	bool "Streamline support via MIPE"
#	depends on MALI_R12P0
#	help
#	  Adds diagnostic support for use with the ARM Streamline Performance Analyzer.
#
#	  Stream will be transmitted directly to Mali GPU library.
#	  Compatible version of the library is required to read debug stream generated by kernel.
#
# endchoice
#	  This is a legacy interface required by older versions of Streamline.

# { SRUK-MALI_SYSTRACE_SUPPORT
config MALI_SYSTRACE_SUPPORT
	bool "systrace Debug support"
	depends on MALI_T8XX
	default y
	help
	  Enable systrace marker in kernel
# SRUK-MALI_SYSTRACE_SUPPORT }

config MALI_DVFS
	bool "Enable DVFS"
	depends on MALI_T8XX
	default n
	help
	  Choose this option to enable DVFS in the Mali Midgard DDK.

config MALI_DVFS_USER
	bool "Enable DVFS USER"
	depends on MALI_T8XX && MALI_DVFS
	default n
	help
	  Choose this option to enable DVFS_USER on MALI t8xx DDK.

config MALI_DVFS_USER_GOVERNOR
	bool "Enable DVFS USER GOVERNOR"
	depends on MALI_T8XX && MALI_DVFS && MALI_DVFS_USER
	default n
	help
	  Choose this option to enable DVFS_USER_GOVERNOR on MALI t8xx DDK.

config MALI_RT_PM
	bool "Enable Runtime power management"
	depends on MALI_T8XX
	depends on PM_RUNTIME
	default y
	help
	  Choose this option to enable runtime power management in the Mali Midgard DDK.

config MALI_MIDGARD_ENABLE_TRACE
	bool "Enable kbase tracing"
	depends on MALI_T8XX
	default n
	help
	  Enables tracing in kbase.  Trace log available through
	  the "mali_trace" debugfs file, when the CONFIG_DEBUG_FS is enabled

config MALI_EXYNOS_TRACE
	bool "Enable kbase tracing"
	depends on MALI_T8XX
	default y
	help
	  Enables tracing in kbase.  Trace log available through
	  the "mali_trace" debugfs file, when the CONFIG_DEBUG_FS is enabled

config MALI_DEBUG_SYS
	bool "Enable sysfs for the Mali Midgard DDK "
	depends on MALI_T8XX && SYSFS
	default n
	help
	  Enables sysfs for the Mali Midgard DDK. Set/Monitor the Mali Midgard DDK

config MALI_DEVFREQ
	bool "devfreq support for Mali"
	depends on MALI_T8XX && PM_DEVFREQ
	help
	  Support devfreq for Mali.

	  Using the devfreq framework and, by default, the simpleondemand
	  governor, the frequency of Mali will be dynamically selected from the
	  available OPPs.

config MALI_DMA_FENCE
	bool "DMA_BUF fence support for Mali"
	depends on MALI_MIDGARD && !KDS
	default n
	help
	  Support DMA_BUF fences for Mali.

	  This option should only be enabled if KDS is not present and
	  the Linux Kernel has built in support for DMA_BUF fences.

# MALI_EXPERT configuration options

menuconfig MALI_EXPERT
	depends on MALI_T8XX
	bool "Enable Expert Settings"
	default n
	help
	  Enabling this option and modifying the default settings may produce a driver with performance or
	  other limitations.

config MALI_PRFCNT_SET_SECONDARY
	bool "Use secondary set of performance counters"
	depends on MALI_MIDGARD && MALI_EXPERT
	default n
	help
	  Select this option to use secondary set of performance counters. Kernel
	  features that depend on an access to the primary set of counters may
	  become unavailable. Enabling this option will prevent power management
	  from working optimally and may cause instrumentation tools to return
	  bogus results.

	  If unsure, say N.

config MALI_DEBUG_SHADER_SPLIT_FS
	bool "Allow mapping of shader cores via sysfs"
	depends on MALI_T8XX && MALI_DEBUG_SYS && MALI_EXPERT
	default n
	help
	  Select this option to provide a sysfs entry for runtime configuration of shader
	  core affinity masks.

config MALI_PLATFORM_FAKE
	bool "Enable fake platform device support"
	depends on MALI_T8XX && MALI_EXPERT
	default n
	help
	  When you start to work with the Mali Midgard series device driver the platform-specific code of
	  the Linux kernel for your platform may not be complete. In this situation the kernel device driver
	  supports creating the platform device outside of the Linux platform-specific code.
	  Enable this option if would like to use a platform device configuration from within the device driver.

config MALI_PLATFORM_THIRDPARTY
    depends on MALI_T8XX
    bool "Third Party Platform"
    default y
      help
      Select the SOC platform that contains a Mali-T8XX

config MALI_PLATFORM_THIRDPARTY_NAME
	depends on MALI_T8XX && MALI_PLATFORM_THIRDPARTY && MALI_EXPERT
	string "Third party platform name"
	help
	  Enter the name of a third party platform that is supported. The third part configuration
	  file must be in midgard/config/tpip/mali_kbase_config_xxx.c where xxx is the name
	  specified here.

config MALI_DEBUG
	bool "Debug build"
	depends on MALI_T8XX && MALI_EXPERT
	default n
	help
	  Select this option for increased checking and reporting of errors.

config MALI_NO_MALI
	bool "No Mali"
	depends on MALI_T8XX && MALI_EXPERT
	default n
	help
	  This can be used to test the driver in a simulated environment
	  whereby the hardware is not physically present. If the hardware is physically
	  present it will not be used. This can be used to test the majority of the
	  driver without needing actual hardware or for software benchmarking.
	  All calls to the simulated hardware will complete immediately as if the hardware
	  completed the task.

config MALI_ERROR_INJECT
	bool "Error injection"
	depends on MALI_T8XX && MALI_EXPERT && MALI_NO_MALI
	default n
	help
	  Enables insertion of errors to test module failure and recovery mechanisms.

config MALI_TRACE_TIMELINE
	bool "Timeline tracing"
	depends on MALI_T8XX && MALI_EXPERT
	default n
	help
	  Enables timeline tracing through the kernel tracepoint system.

config MALI_SYSTEM_TRACE
	bool "Enable system event tracing support"
	depends on MALI_T8XX && MALI_EXPERT
	default n
	help
	  Choose this option to enable system trace events for each
	  kbase event.	This is typically used for debugging but has
	  minimal overhead when not in use. Enable only if you know what
	  you are doing.

config MALI_SEC_HWCNT
	bool "Enable sec hwcnt feature"
	depends on MALI_T8XX
	default n
	help
	  Enable sec hwcnt feature.

source "drivers/gpu/arm/t8xx/r12p0/platform/Kconfig"
```

## drivers/gpu/arm/t8xx/r22p0/platform/exynos/Kconfig
```kconfig
#
# (C) COPYRIGHT 2012-2013, 2017 ARM Limited. All rights reserved.
#
# This program is free software and is provided to you under the terms of the
# GNU General Public License version 2 as published by the Free Software
# Foundation, and any use by you of this program is subject to the terms
# of such GNU licence.
#
# This program is distributed in the hope that it will be useful,
# but WITHOUT ANY WARRANTY; without even the implied warranty of
# MERCHANTABILITY or FITNESS FOR A PARTICULAR PURPOSE.  See the
# GNU General Public License for more details.
#
# You should have received a copy of the GNU General Public License
# along with this program; if not, you can access it online at
# http://www.gnu.org/licenses/gpl-2.0.html.
#
# SPDX-License-Identifier: GPL-2.0
#
#



# Add your platform specific Kconfig file here
#
# "drivers/gpu/arm/.../platform/Kconfig"
#
# Where xxx is the platform name is the name set in MALI_PLATFORM_THIRDPARTY_NAME
#
config EXYNOS_SOC_NAME
    depends on MALI_T8XX
    string "Third party soc name"
    help
      soc name.

# { SRUK-MALI_SYSTRACE_SUPPORT
config MALI_SYSTRACE_SUPPORT
    bool "Enable Exynos systrace Debug support"
    depends on MALI_T8XX
    default y
    help
      Enable systrace marker in kernel
# SRUK-MALI_SYSTRACE_SUPPORT }

config MALI_SEC_HWCNT
    bool "Enable sec hwcnt feature"
    depends on MALI_T8XX
    default n
    help
      Enable sec hwcnt feature.

config MALI_DVFS
    bool "Enable EXYNOS DVFS"
    depends on MALI_T8XX
    default n
    help
      Choose this option to enable DVFS in the Mali Midgard DDK.

config MALI_RT_PM
    bool "Enable EXYNOS Runtime power management"
    depends on MALI_T8XX
    depends on PM
    default y
    help
      Choose this option to enable runtime power management in the Mali Midgard DDK.

config MALI_EXYNOS_TRACE
    bool "Enable EXYNOS kbase tracing"
    depends on MALI_T8XX
    default y
    help
      Enables tracing in kbase.  Trace log available through
      the "mali_trace" debugfs file, when the CONFIG_DEBUG_FS is enabled

config MALI_DEBUG_SYS
    bool "Enable sysfs for the Mali Midgard DDK "
    depends on MALI_T8XX && SYSFS
    default y
    help
      Enables sysfs for the Mali Midgard DDK. Set/Monitor the Mali Midgard DDK

config MALI_SEC_CL_BOOST
    bool "Enable EXYNOS cl booster"
    depends on MALI_T8XX
    default y
    help
      Enables open cl dvfs booster.


config MALI_SEC_UTILIZATION
    bool "Enable EXYNOS custom utilization"
    depends on MALI_T8XX
    default y
    help
      Enables exynos custom utilization.

config MALI_PM_QOS
    bool "Enable DVFS with QoS"
    depends on MALI_T8XX && MALI_DVFS && PM_DEVFREQ && CPU_FREQ
    default y
    help
      Choose this option to enable PM_QOS in the Mali tMIX DDK.

config MALI_BTS_OPTIMIZATION
    bool "Enable GPU BTS"
    depends on MALI_DVFS
    default n
    help
      Choose this option to enable BTS in the Mali tMIX DDK.

config MALI_DEBUG_KERNEL_SYSFS
   bool "Support Kernel Group Debug SysFS"
   depends on MALI_T8XX && MALI_DEBUG_SYS
   default n
   help
	   Support Support Kernel Group Debug SysFS on /sys/kernel/gpu

config MALI_EXYNOS_SECURE_RENDERING
    bool "Enable EXYNOS Secure Rendering Support"
    depends on MALI_T8XX && ION_EXYNOS && EXYNOS_CONTENT_PATH_PROTECTION
    default n
    help
      Support Secure Rendering on Exynos SoC

config MALI_SEC_ASP_SECURE_BUF_CTRL
    bool "Enable EXYNOS Secure Rendering whit ASP Support"
    depends on MALI_T8XX && MALI_EXYNOS_SECURE_RENDERING && ION_EXYNOS && EXYNOS_CONTENT_PATH_PROTECTION
    default n
    help
      Support Secure Rendering with ASP on Exynos SoC

config MALI_SEC_JOB_STATUS_CHECK
	bool "Enable GPU JOB & FENCE STATUS DUMP "
	depends on MALI_RT_PM && MALI_DVFS && (SYNC || SYNC_FILE)
	default y
	help
	  Choose this option to enable job & fence status dump feature in the Mali Midgard DDK.
```

## drivers/gud/Kconfig
```kconfig
#
# Mobicore Configuration
#

config SOC_EXYNOS8890_KINIBI311
        bool "Enable kinibi311"
        default n


if SOC_EXYNOS8890 && SOC_EXYNOS8890_KINIBI311
source "drivers/gud/gud-exynos8890_kinibi311/Kconfig"
source "drivers/gud/TlcTui/Kconfig"
endif

if SOC_EXYNOS8890 && !SOC_EXYNOS8890_KINIBI311
source "drivers/gud/gud-exynos8890/Kconfig"
source "drivers/gud/TlcTui/Kconfig"
endif
```

## drivers/gud/TlcTui/Kconfig
```kconfig
config TRUSTONIC_TRUSTED_UI
	tristate "TBase Trusted UI"
	depends on TRUSTONIC_TEE
	---help---
	Enable Linux Kernel Tusted UI

config TRUSTONIC_TRUSTED_UI_FB_BLANK
	bool "TBase Trusted UI use fb_blank"
	default y
	depends on TRUSTONIC_TRUSTED_UI

config TRUSTED_UI_TOUCH_ENABLE
	bool "TBase Trusted UI use touch related code"
	default y
	depends on TRUSTONIC_TRUSTED_UI
```

## drivers/gud/gud-exynos8890_kinibi311/sec-os-booster/Kconfig
```kconfig
#
# Secure OS control configuration
#
config SECURE_OS_BOOSTER_API
	bool "Secure OS booster API"
	depends on TRUSTONIC_TEE
	---help---
	  The secure OS booster API is used for secure OS performance
	  enhancement. It can migrate a core that executes secure OS tasks
	  and lock CPU frequency.
```

## drivers/input/keyboard/cypress/Kconfig
```kconfig
#
# Cypress touchkey configuration
#

config KEYBOARD_CYPRESS_TOUCH_20075
	tristate "Cypress touchkey support"
	help
	  Say Y here to enable the cypress touchkey.

	  To compile this driver as a module, choose M here.

config KEYBOARD_CYPRESS_TOUCH_MBR31X5
	tristate "Cypress touchkey support"
	help
	  Say Y here to enable the cypress touchkey.

	  To compile this driver as a module, choose M here.

config KEYBOARD_THD_CHANGE_AS_FINGERPRINT
	tristate "Cypress touchkey support"
	help
	  Say Y here to enable thd change func.
	  To avoid noise of fingerprint transfer, apply upper thd to touchkey

	  To compile this driver as a module, choose M here.
```

## drivers/input/touchscreen/g2touch/Kconfig
```kconfig
#
# G2 Touchscreen driver configuration
#

config TOUCHSCREEN_G2TOUCH
	tristate "G2TOUCH touchscreens"
	help
	  Say Y here if you want support for G2Touch touchscreen 
		controllers.
```

## drivers/input/touchscreen/mxt_t/Kconfig
```kconfig
#
# ATMEL T TOUCH driver configuration
#
config TOUCHSCREEN_ATMEL_MXT1664
	tristate "Atmel MXT T serise I2C touchscreen"
	depends on I2C
	help
	  Say Y here if you have a Atmel MXT T I2C touchscreen
	  connected to your system.

	  If unsure, say N.

config TOUCHSCREEN_ATMEL_MXT874U
	tristate "Atmel MXT T serise I2C touchscreen"
	depends on I2C
	help
	  Say Y here if you have a Atmel MXT T I2C touchscreen
	  connected to your system.

	  If unsure, say N.
```

## drivers/input/touchscreen/stm/fts7/Kconfig
```kconfig
#
# STMicroelectronics TOUCH driver configuration
#

config TOUCHSCREEN_FTS7
	tristate "STMicroelectronics i2c multitouch touchscreen with FingerTipS"
	depends on I2C
	help
		Say Y here to enable STMicroelectronics touchscreen support.
		If unsure, say N.
		To compile this driver as a module, choose M here: the
		module will be called STM_ts.

config TOUCHSCREEN_FTS7_VALLEY
	tristate "STMicroelectronics i2c multitouch touchscreen with FingerTipS"
	depends on I2C
	help
		Say Y here to enable STMicroelectronics touchscreen for valley model support.
		If unsure, say N.
		To compile this driver as a module, choose M here: the
		module will be called STM_ts.

config TOUCHSCREEN_FTS7_HAECHI
	tristate "STMicroelectronics i2c multitouch touchscreen with FingerTipS"
	depends on I2C
	help
		Say Y here to enable STMicroelectronics touchscreen for haechi model support.
		If unsure, say N.
		To compile this driver as a module, choose M here: the
		module will be called STM_ts.
```

## drivers/input/touchscreen/synaptics_dsx2/Kconfig
```kconfig
#
# SYNAPTICS TOUCH driver configuration
#

config TOUCHSCREEN_SYNAPTICS_I2C_DSX2
	tristate "Synaptics DSX2 i2c touchscreen base on bootloader Ver7"
	depends on I2C
	help
	  This enables support for Synaptics DSX2 over I2C based touchscreens.
```
