## drivers/input/wacom/Kconfig
```kconfig
#
# Wacom configuration
#

config INPUT_WACOM
	tristate "Wacom penabled i2c touchscreen"
	depends on I2C
	help
	  Say Y here if you have an Wacom penabled i2c touchscreen
	  connected to your system.

	  If unsure, say N.

	  To compile this driver as a module, choose M here: the
	  module will be called wacom_GXXX.

config EPEN_WACOM_G5SP
	tristate "Wacom G5SP penabled i2c touchscreen"
	depends on I2C
	help
	  Say Y here if you have an Wacom G5SP penabled i2c touchscreen
	  connected to your system.

	  If unsure, say N.

	  To compile this driver as a module, choose M here: the
	  module will be called wacom_G5SP.

config EPEN_WACOM_G9PM
	tristate "Wacom G9PM penabled i2c touchscreen"
	depends on I2C
	help
	  Say Y here if you have an Wacom G9PM penabled i2c touchscreen
	  connected to your system.

	  If unsure, say N.

	  To compile this driver as a module, choose M here: the
	  module will be called wacom_G9PM.

config EPEN_WACOM_G9PL
	tristate "Wacom G9PL penabled i2c touchscreen"
	depends on I2C
	help
	  Say Y here if you have an Wacom G9PL penabled i2c touchscreen
	  connected to your system.

	  If unsure, say N.

	  To compile this driver as a module, choose M here: the
	  module will be called wacom_G9PL.

config EPEN_WACOM_G9PLL
	tristate "Wacom G9PLL penabled i2c touchscreen"
	depends on I2C
	help
	  Say Y here if you have an Wacom G9PLL penabled i2c touchscreen
	  connected to your system.

	  If unsure, say N.

	  To compile this driver as a module, choose M here: the
	  module will be called wacom_G9PLL.

config EPEN_WACOM_G10PM
	tristate "Wacom G10PM penabled i2c touchscreen"
	depends on I2C
	help
	  Say Y here if you have an Wacom G10PM penabled i2c touchscreen
	  connected to your system.

	  If unsure, say N.

	  To compile this driver as a module, choose M here: the
	  module will be called wacom_G10PM.

config EPEN_WACOM_W9012
	tristate "Wacom W9012 penabled i2c touchscreen"
	depends on I2C
	help
	  Say Y here if you have an Wacom G10PM penabled i2c touchscreen
	  connected to your system.

	  If unsure, say N.

	  To compile this driver as a module, choose M here: the
	  module will be called wacom_W9012.

config EPEN_WACOM_W9014
	tristate "Wacom W9014 penabled i2c touchscreen"
	depends on I2C
	help
	  Say Y here if you have an Wacom G10PM penabled i2c touchscreen
	  connected to your system.

	  If unsure, say N.

	  To compile this driver as a module, choose M here: the
	  module will be called wacom_W9014.

config EPEN_WACOM_W9018
	tristate "Wacom W9018 penabled i2c touchscreen"
	depends on I2C
	help
	  Say Y here if you have an Wacom G10PM penabled i2c touchscreen
	  connected to your system.

	  If unsure, say N.

	  To compile this driver as a module, choose M here: the
	  module will be called wacom_W9018.


config WACOM_LCD_FREQ_COMPENSATE
	bool "Wacom LCD vsync/hsync frequency compensate rotuine"
	help
	  Say Y here if you have an Wacom lcd freq compensate config

	  If unsure, say N.

	  To compile this driver as a module, choose M here: the
	  module will be called wacom.
```

## drivers/mailbox/samsung/Kconfig
```kconfig
config EXYNOS_APM
	bool "APM Driver"
	select MAILBOX
	select EXYNOS_MBOX

if EXYNOS_APM

config EXYNOS_MBOX
	tristate "Exynos Mailbox Controller"
	help
	  An implementation of the Samsung Interprocessor Communication
	  Mailbox (IPCM). It is used to send short messages between CortexM3 cores
	  and the Power Control Processor or Power Coprocessor firmware.
	  Say Y here if you want to use the Exynos mailbox support.

config EXYNOS8890_APM
	bool "EXYNOS8890 APM Driver"
	default y
	depends on SOC_EXYNOS8890

menu "EXYNOS_CL_DVFS"

config EXYNOS_CL_DVFS_CPU
	bool "EXYNOS_CL_DVFS_CPU"
	help
	 CPU closed loop dvfs feature
config EXYNOS_CL_DVFS_G3D
	bool "EXYNOS_CL_DVFS_G3D"
	help
	 G3D closed loop dvfs feature
config EXYNOS_CL_DVFS_MIF
	bool "EXYNOS_CL_DVFS_MIF"
	help
	 MIF closed loop dvfs feature

endmenu

choice
	prompt "Default communction mode"
	depends on EXYNOS_MBOX
	default EXYNOS_MBOX_DEFAULT_POLLING
	help

config EXYNOS_MBOX_DEFAULT_INTERRUPT
	bool "Interrupt"
	select EXYNOS_MBOX_INTERRUPT
	help
	 This select is interrupt mode.
config EXYNOS_MBOX_DEFAULT_POLLING
	bool "Polling"
	select EXYNOS_MBOX_POLLING
	help
	 This select is interrupt mode.
endchoice

config EXYNOS_MBOX_INTERRUPT
	depends on EXYNOS_MBOX
	tristate "Interrupt mode"
config EXYNOS_MBOX_POLLING
	depends on EXYNOS_MBOX
	tristate "Polling mode"

config EXYNOS_APM_VOLTAGE_DEBUG
	bool "APM Voltage Debug"
	default y
endif
```

## drivers/media/platform/exynos/Kconfig
```kconfig
#
# Exynos multimedia device drivers
#
config VIDEO_EXYNOS
        bool "Exynos Multimedia Devices"
        depends on ARCH_EXYNOS
        default y
        help
          This is a representative exynos multimedia device.

if VIDEO_EXYNOS
        source "drivers/media/platform/exynos/mdev/Kconfig"
        source "drivers/media/platform/exynos/scaler/Kconfig"
        source "drivers/media/platform/exynos/mfc/Kconfig"
	source "drivers/media/platform/exynos/hevc/Kconfig"
	source "drivers/media/platform/exynos/fimg2d_v5/Kconfig"
	source "drivers/media/platform/exynos/smfc/Kconfig"
	source "drivers/media/platform/exynos/fimc-is2/Kconfig"
endif

config MEDIA_EXYNOS
        bool
        depends on VIDEO_EXYNOS
        default y
        help
          Compile mdev to use exynos media device driver.
```

## drivers/media/platform/exynos/fimc-is2/Kconfig
```kconfig
config VIDEO_EXYNOS_FIMC_IS2
	bool "Exynos FIMC-IS2 (Image Subsystem) driver"
	depends on VIDEO_EXYNOS
	select MEDIA_EXYNOS
	select EXYNOS_MIPI_CSIS
	select EXYNOS_FIMC_BNS
	select EXYNOS_FIMC_IS
	select VENDER_FEATURE
	default n
	help
	  This is a v4l2 driver for exynos FIMC-IS device.

source "drivers/media/platform/exynos/fimc-is2/sensor/Kconfig"
source "drivers/media/platform/exynos/fimc-is2/ischain/Kconfig"
source "drivers/media/platform/exynos/fimc-is2/vendor/Kconfig"
source "drivers/media/platform/exynos/fimc-is2/hardware/Kconfig"
```

## drivers/media/platform/exynos/fimc-is2/hardware/Kconfig
```kconfig
config USE_DIRECT_IS_CONTROL
	bool "Use IS hardware directly"
	depends on VIDEO_EXYNOS_FIMC_IS2
	default n
	help
	  Enable HW direct control.

config EXYNOS_FIMC_IS_HARDWARE
        bool "Use FIMC-IS HARDWARE"
        depends on VIDEO_EXYNOS_FIMC_IS2
        depends on !USE_DIRECT_IS_CONTROL
        default y
        help
          fimc-is hardware

config CAMERA_FIMC_SCALER_USE
        bool "Use FIMC-SCALER"
        depends on USE_DIRECT_IS_CONTROL
        default n
        help
          use fimc-scaler

config CAMERA_MC_SCALER_USE
        bool "Use MC-SCALER"
        depends on USE_DIRECT_IS_CONTROL
        default n
        help
          use mc-scaler

source "drivers/media/platform/exynos/fimc-is2/hardware/api/Kconfig"
```

## drivers/media/platform/exynos/fimc-is2/hardware/api/Kconfig
```kconfig
config USE_HW_API_COMMON
	bool "Use HW API Common library"
	depends on EXYNOS_FIMC_IS_HARDWARE
	default y
	help
	  Enalbe HW API Common library.
```
