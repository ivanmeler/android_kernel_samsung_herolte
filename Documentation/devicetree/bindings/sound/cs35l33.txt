## Documentation/devicetree/bindings/sound/cs35l33.txt
```
CS35L33 Speaker Amplifier

Required properties:

  - compatible : "cirrus,cs35l33"

  - reg : the I2C address of the device for I2C

  - VA-supply, VP-supply : power supplies for the device,
    as covered in
    Documentation/devicetree/bindings/regulator/regulator.txt.

Optional properties:

  - cirrus,reset-gpios : gpio used to reset the amplifier

  - cirrus,irq-gpios: gpio used to simulate level triggered irqs

  - cirrus,boost-ctl : Booster voltage use to supply the amp, if this is not
    set then the internal 1.0V LDO will supply the amp.

  - cirrus,ramp-rate : On power up, it affects the time from when the power
    up sequence begins to the time the audio reaches a full-scale output.
    On power down, it affects the time from when the power-down sequence
    begins to when the amplifier disables the PWM outputs. If this property
    is not set then soft ramping will be disabled and ramp time would be
    20ms. If this property is set to 0,1,2,3 then ramp times would be 40ms,
    60ms,100ms,175ms respectively for 48KHz sample rate.

  - cirrus,boost-ipk : Booster peak current

  - cirrus,hg-algo : parameters for internal h/g algorithm that controls
    the amplifier supplies

Example:

cs35l33: cs35l33@40 {
	compatible = "cirrus,cs35l33";
	reg = <0x40>;

	VA-supply = <&ldo5_reg>;
	VP-supply = <&ldo5_reg>;

	interrupt-parent = <&cs47l91>;
	interrupts = <3 0>;
	irq-gpios = <&cs47l91 3 0>;

	reset-gpios = <&cs47l91 34 0>;

	ramp-rate = <0x0>;
	boost-ctl = <0x0>;
	boost-ipk = <0xE0>;

	hg-algo {
		mem-depth = <0x3>;
		release-rate = <0x3>;
		hd-rm = <0xA>;
		ldo-thld = <0x1>;
		ldo-path-disable = <0x0>;
		ldo-entry-delay=<0x4>;
		vp-hg-auto;
		vp-hg=<0xF>;
		vp-hg-rate=<0x2>;
		vp-hg-va=<0x0>;
	};
};
```

## drivers/ccic/Kconfig
```kconfig
#
# CCIC devices
#

comment "CCIC configs"

config CCIC_NOTIFIER
	bool "CCIC notifier support"
	depends on I2C
	default n
	help
	  If you say yes here you will get support for
	  the CCIC attached device status change notification.

config CCIC_S2MM003 
	bool "CCIC S2MM003"
	depends on I2C 
	default n
	help
	  If you say yes here you will get support for
	  s2mm003 ccic full version chipset 

config CCIC_S2MM005 
	bool "CCIC S2MM005"
	depends on I2C 
	default n
	help
	  If you say yes here you will get support for
	  s2mm005 ccic full version chipset 

config CCIC_ALTERNATE_MODE 
	bool "support CCIC alternate mode"
	depends on I2C
	default n
	help
	  If you say yes here you will get support for
	  alternate mode

config CCIC_LPM_ENABLE
	bool "Support LPM ENABLE"
	depends on CCIC_S2MM005
	default n
	help
	  If you say yes here you will get support for
	  lpm enable

config CCIC_WATER_DETECT
	bool "support WATER DETECT"
	depends on CCIC_S2MM005
	default n
	help
	  If you say yes here you will get support for
	  water detect Enable
```

## drivers/char/exynos-mcomp/Kconfig
```kconfig
#
# MCOMP devices
#

config EXYNOS_MCOMP
	bool "Exynos memory compressor"
	default y
	depends on ESWAP && ZONE_DMA
	help
	  Memory compressor
```

## drivers/cpuidle/Kconfig.arm64
```kconfig
#
# ARM64 CPU Idle drivers
#

config ARM64_CPUIDLE
	bool "Generic ARM64 CPU idle Driver"
	select ARM64_CPU_SUSPEND
	select DT_IDLE_STATES
	help
	  Select this to enable generic cpuidle driver for ARM64.
	  It provides a generic idle driver whose idle states are configured
	  at run-time through DT nodes. The CPUidle suspend backend is
	  initialized by calling the CPU operations init idle hook
	  provided by architecture code.

config ARM64_EXYNOS_CPUIDLE
	bool "Cpu Idle Driver for the ARM64 Exynos processors"
	depends on ARCH_EXYNOS
	select ARM64_CPU_SUSPEND
	select CPU_IDLE_MULTIPLE_DRIVERS
	select DT_IDLE_STATES
	help
	  Select this to enable cpuidle for ARM64 Exynos processors.
```

## drivers/crypto/fmp/Kconfig
```kconfig
config FMP_UFS
	tristate "Samsung EXYNOS FMP Driver for UFS"
	depends on SCSI_UFSHCD && SCSI_UFSHCD_PLATFORM
	---help---
	  This selects EXYNOS FMP UFS driver.

	  If you have a controller with this interface, say Y here.

	  If unsure, say N.

config FIPS_FMP
	tristate "Samsung EXYNOS FMP Validation Driver for FIPS"
	depends on FMP_UFS
	depends on !FUNCTION_TRACER
	---help---
	  This selects Samsung EXYNOS FMP Validation driver for FIPS.

	  If you have a controller with this interface, say Y here.

	  If unsure, say N.

choice
	prompt "Option for self-test failure"
	depends on FIPS_FMP
	default NODE_FOR_SELFTEST_FAIL

config NODE_FOR_SELFTEST_FAIL
	bool "Set fips fmp node when self-test fails"
	depends on FIPS_FMP
	help
	   This select that fips fmp node was set to zero when FMP self-test fails.

config PANIC_FOR_SELFTEST_FAIL
	bool "Panic when self-test fails"
	depends on FIPS_FMP
	help
	   This select that kernel panic occurs when FMP self-test fails.

endchoice
```

## drivers/devfreq/Kconfig
```kconfig
menuconfig PM_DEVFREQ
	bool "Generic Dynamic Voltage and Frequency Scaling (DVFS) support"
	help
	  A device may have a list of frequencies and voltages available.
	  devfreq, a generic DVFS framework can be registered for a device
	  in order to let the governor provided to devfreq choose an
	  operating frequency based on the device driver's policy.

	  Each device may have its own governor and policy. Devfreq can
	  reevaluate the device state periodically and/or based on the
	  notification to "nb", a notifier block, of devfreq.

	  Like some CPUs with CPUfreq, a device may have multiple clocks.
	  However, because the clock frequencies of a single device are
	  determined by the single device's state, an instance of devfreq
	  is attached to a single device and returns a "representative"
	  clock frequency of the device, which is also attached
	  to a device by 1-to-1. The device registering devfreq takes the
	  responsibility to "interpret" the representative frequency and
	  to set its every clock accordingly with the "target" callback
	  given to devfreq.

	  When OPP is used with the devfreq device, it is recommended to
	  register devfreq's nb to the OPP's notifier head.  If OPP is
	  used with the devfreq device, you may use OPP helper
	  functions defined in devfreq.h.

if PM_DEVFREQ

comment "DEVFREQ Governors"

config DEVFREQ_GOV_SIMPLE_ONDEMAND
	tristate "Simple Ondemand"
	help
	  Chooses frequency based on the recent load on the device. Works
	  similar as ONDEMAND governor of CPUFREQ does. A device with
	  Simple-Ondemand should be able to provide busy/total counter
	  values that imply the usage rate. A device may provide tuned
	  values to the governor with data field at devfreq_add_device().

config DEVFREQ_GOV_SIMPLE_USAGE
	tristate "Simple Usage"
	help
	  Chooses frequency based on the percentage of target device.

config DEVFREQ_GOV_SIMPLE_EXYNOS
	tristate "Simple Exynos"
	help
	  Chooses frequency based on the threshold of target device.

config DEVFREQ_GOV_PERFORMANCE
	tristate "Performance"
	help
	  Sets the frequency at the maximum available frequency.
	  This governor always returns UINT_MAX as frequency so that
	  the DEVFREQ framework returns the highest frequency available
	  at any time.

config DEVFREQ_GOV_POWERSAVE
	tristate "Powersave"
	help
	  Sets the frequency at the minimum available frequency.
	  This governor always returns 0 as frequency so that
	  the DEVFREQ framework returns the lowest frequency available
	  at any time.

config DEVFREQ_GOV_USERSPACE
	tristate "Userspace"
	help
	  Sets the frequency at the user specified one.
	  This governor returns the user configured frequency if there
	  has been an input to /sys/devices/.../power/devfreq_set_freq.
	  Otherwise, the governor does not change the frequnecy
	  given at the initialization.

comment "DEVFREQ Drivers"

config ARM_EXYNOS_DEVFREQ
	bool "ARM Exynos Memory Bus DEVFREQ Common driver"
	depends on ARCH_EXYNOS
	select ARCH_HAS_OPP
	select PM_OPP
	help
	  This adds the DEVFREQ driver for Exynos series common bus.

config ARM_EXYNOS_DEVFREQ_DEBUG
	bool "ARM Exynos DEVFREQ sysfs for Debug"
	depends on ARM_EXYNOS_DEVFREQ

config ARM_EXYNOS4_BUS_DEVFREQ
	bool "ARM Exynos4210/4212/4412 Memory Bus DEVFREQ Driver"
	depends on (CPU_EXYNOS4210 || SOC_EXYNOS4212 || SOC_EXYNOS4412) && !ARCH_MULTIPLATFORM
	select DEVFREQ_GOV_SIMPLE_ONDEMAND
	select PM_OPP
	help
	  This adds the DEVFREQ driver for Exynos4210 memory bus (vdd_int)
	  and Exynos4212/4412 memory interface and bus (vdd_mif + vdd_int).
	  It reads PPMU counters of memory controllers and adjusts
	  the operating frequencies and voltages with OPP support.
	  This does not yet operate with optimal voltages.

config ARM_EXYNOS5_BUS_DEVFREQ
	tristate "ARM Exynos5250 Bus DEVFREQ Driver"
	depends on SOC_EXYNOS5250
	select DEVFREQ_GOV_SIMPLE_ONDEMAND
	select PM_OPP
	help
	  This adds the DEVFREQ driver for Exynos5250 bus interface (vdd_int).
	  It reads PPMU counters of memory controllers and adjusts the
	  operating frequencies and voltages with OPP support.

config ARM_EXYNOS8890_BUS_DEVFREQ
	bool "ARM Exynos8890 Memory Bus DEVFREQ Driver"
	default y
	depends on ARM_EXYNOS_DEVFREQ
	depends on SOC_EXYNOS8890
	select DEVFREQ_GOV_SIMPLE_ONDEMAND
	select DEVFREQ_GOV_SIMPLE_EXYNOS
	help
	  This adds the DEVFREQ driver for Exynos8890 memory and int.

endif # PM_DEVFREQ
```

## drivers/fingerprint/Kconfig
```kconfig
#
# Sensor  drivers configuration
#
menuconfig SENSORS_FINGERPRINT
	bool "Finger Print Sensor devices"
	help
	  Say Y here, and a list of sensors drivers will be displayed.
	  Everything that didn't fit into the other categories is here. This option
	  doesn't affect the kernel.
	  If unsure, say Y.

if SENSORS_FINGERPRINT
config SENSORS_FINGERPRINT_SYSFS
	tristate "fingerprint sensor sysfs support"
	default n
	help
	  If you say yes here you get support for
	  fingerprint sensor FINGERPRINT_SYSFS
config SENSORS_VFS7XXX
	tristate "VFS7XXX fingerprint sensor support"
	default n
	help
	  If you say yes here you get support for Validity's
	  fingerprint sensor VFS7XXX.
config SENSORS_FPRINT_SECURE
	tristate "VFS61XX fingerprint sensor support"
	default n
	help
	  If you say yes here you get support for Validity's
	  fingerprint sensor enable secure zone.
config SENSORS_FINGERPRINT_32BITS_PLATFORM_ONLY
	tristate "Fingerprint sensor supports only 32bits platform"
	default n
	help
	  If you say yes here the non TZ device driver will only supports
	  32bits platform.
config SENSORS_ET320
	tristate "ET320 fingerprint sensor supprot"
	default n
	help
	  If you say yes here you get support for Egistec's
	  fingerprint sensor ET320.
config SENSORS_FINGERPRINT_DUALIZATION
	tristate "Fingerprint sensor supports dualization et320 and viper2"
	default n
	help
	  If you say yes here vendor pin check will be enabled.
config SENSORS_FP_LOCKSCREEN_MODE
	tristate "fingerprint sensor support fast wake up"
	default n
	help
	  If you say yes here you can use lockscreen mode for optimizing
config SENSORS_FP_TKEY_NOTI
	tristate "fingerprint sensor support tkey notification"
	default n
	help
	  If you say yes here you can use fingerprint sensor tkey notification
endif
```

## drivers/gps/Kconfig
```kconfig
config GPS_BCMxxxxx
	bool "BROADCOM_GPS_CHIPSET_COMMON"
	default n

config GPS_BCM4752
	bool "BROADCOM_GPS_CHIPSET_4752"
	default n

config GPS_BCM47521
	bool "BROADCOM_GPS_CHIPSET_47521"
	default n

config GPS_BCM4753
	bool "BROADCOM_GPS_CHIPSET_4753"
	default n

config GPS_BCM47531
	bool "BROADCOM_GPS_CHIPSET_47531"
	default n

config GPS_BCM4773
	bool "BROADCOM_GPS_CHIPSET_4773"
	default n
```

## drivers/gpu/arm/t8xx/Kconfig
```kconfig
#
# (C) COPYRIGHT 2012-2013 ARM Limited. All rights reserved.
#
# This program is free software and is provided to you under the terms of the
# GNU General Public License version 2 as published by the Free Software
# Foundation, and any use by you of this program is subject to the terms
# of such GNU licence.
#
# A copy of the licence is included with the program, and can also be obtained
# from Free Software Foundation, Inc., 51 Franklin Street, Fifth Floor,
# Boston, MA  02110-1301, USA.
#
#
config DDK_VERSION_OS
	string "version"
	default ANDROID_MAJOR_VERSION
	help
		Android OS major version

menuconfig MALI_T8XX
	tristate "Mali-T8XX support"
	default y
	help
	  Enable this option to build support for the ARM Mali-T7xx GPU.

	  To compile this driver as a module, choose M here:
	  this will generate a single module, called mali_kbase.

choice
	prompt "version Configuration"
	depends on MALI_T8XX
	default MALI_R12P0 if DDK_VERSION_OS = "m"
	default MALI_R12P0 if DDK_VERSION_OS = "n"
	default MALI_R22P0 if DDK_VERSION_OS = "o"
	help
	  Select the gpu support version.

config MALI_R7P0
	depends on MALI_T8XX
	bool "r7p0 driver"

config MALI_R9P0
	depends on MALI_T8XX
	bool "r9p0 driver"

config MALI_R12P0
	depends on MALI_T8XX
	bool "r12p0 driver"

config MALI_R15P0
	depends on MALI_T8XX
	bool "r15p0 driver"

config MALI_R22P0
	depends on MALI_T8XX
	bool "r22p0 driver"

endchoice
	

if MALI_R7P0
	source "drivers/gpu/arm/t8xx/r7p0/Kconfig"
endif

if MALI_R9P0
	source "drivers/gpu/arm/t8xx/r9p0/Kconfig"
endif

if MALI_R12P0
	if DDK_VERSION_OS = "n"
	source "drivers/gpu/arm/t8xx/r12p0_n/Kconfig"
	endif
	if DDK_VERSION_OS = "m"
	source "drivers/gpu/arm/t8xx/r12p0_m/Kconfig"
	endif
endif

if MALI_R15P0
	source "drivers/gpu/arm/t8xx/r15p0/Kconfig"
endif

if MALI_R22P0
	source "drivers/gpu/arm/t8xx/r22p0/Kconfig"
endif
```
